## arch/arm/src/armv8-m/Kconfig
```kconfig
#
# For a description of the syntax of this configuration file,
# see the file kconfig-language.txt in the NuttX tools repository.
#

comment "ARMv8-M Configuration Options"

config ARMV8M_HAVE_ICACHE
	bool
	default n

config ARMV8M_HAVE_DCACHE
	bool
	default n

config ARMV8M_ICACHE
	bool "Use I-Cache"
	default n
	depends on ARMV8M_HAVE_ICACHE
	select ARCH_ICACHE

config ARMV8M_DCACHE
	bool "Use D-Cache"
	default n
	depends on ARMV8M_HAVE_DCACHE
	select ARCH_DCACHE

config ARMV8M_DCACHE_WRITETHROUGH
	bool "D-Cache Write-Through"
	default n
	depends on ARMV8M_DCACHE

config ARMV8M_LAZYFPU
	bool "Use lazy FPU exception frames"
	default n
	depends on ARCH_FPU
	---help---
		Keep CONTROL.FPCA clear for threads that have not executed FP
		instructions, and let the hardware set FPCA automatically when FP
		state is used.  This avoids the extended FP exception frame on
		integer-only threads.

config ARMV8M_SYSCALL_BARRIER
	bool "Issue barriers before returning from SVC"
	default n
	depends on BUILD_PROTECTED
	---help---
		Issue DSB/ISB before returning from the ARMv8-M SVC handler.  This
		is useful when validating protected-mode system calls on external
		cacheable process stacks, where both the user stack frame and the
		SVC exception frame can live outside internal SRAM.

config ARMV8M_BASEPRI_ISB
	bool "Issue ISB after BASEPRI writes"
	default n
	---help---
		Issue an ISB after writing BASEPRI in the Armv8-M IRQ save and
		restore path.  This is useful on cores where code immediately
		depends on interrupts being unmasked after lowering the BASEPRI
		priority boost.

config ARMV8M_SYSCALL_RETURN_CURRENT_FRAME
	bool "Preserve the active SVC frame shape on syscall return"
	default n
	depends on BUILD_PROTECTED && LIB_SYSCALL
	---help---
		Preserve the standard/extended FP frame bit from the active
		SYS_syscall_return SVC frame instead of blindly restoring the bit
		from the original user SVC.  This avoids a lazy-FPU protected-mode
		syscall return path changing frame shape while exception return is
		decoding the active stack frame.

config ARMV8M_SYSCALL_RETURN_USER_BASEPRI0
	bool "Clear BASEPRI before returning from syscall to user mode"
	default n
	depends on BUILD_PROTECTED && LIB_SYSCALL
	---help---
		Clear the saved BASEPRI field in the active SVC frame before
		SYS_syscall_return returns to unprivileged thread mode.  This is
		useful for protected-mode blocking syscalls that must not resume a
		user task with an interrupt priority mask inherited from a kernel
		critical section.

config ARMV8M_SYSCALL_DISPATCH_BASEPRI0
	bool "Clear BASEPRI before entering syscall dispatcher"
	default n
	depends on BUILD_PROTECTED && LIB_SYSCALL
	---help---
		Clear the saved BASEPRI field in the SVC frame before returning
		to the privileged syscall dispatcher.  This prevents a stale user
		BASEPRI value from being inherited by kernel syscall code such as
		serial write paths that depend on interrupts.

config ARMV8M_SYSCALL_KERNEL_STACK
	bool "Run protected syscall dispatcher on a kernel stack"
	default n
	depends on BUILD_PROTECTED && LIB_SYSCALL
	depends on ARCH_INTERRUPTSTACK > 7
	---help---
		Return from the user SVC frame to the privileged syscall dispatcher
		using a per-thread kernel stack instead of the process stack.  This
		keeps blocking kernel syscall paths off external user stacks while
		still allowing ordinary user task and pthread stacks to live in
		external RAM.  This requires a real interrupt stack because the
		SVC handler must not free or reuse the syscall stack it is running
		on.

config ARMV8M_SYSCALL_KERNEL_STACKSIZE
	int "Protected syscall kernel stack size"
	default 4096
	depends on ARMV8M_SYSCALL_KERNEL_STACK
	---help---
		Size, in bytes, of the per-thread internal stack used while running
		protected-mode syscall dispatcher and kernel syscall code.

config ARMV8M_SYSCALL_KERNEL_STACK_BASIC_FRAME
	bool "Use a basic FP frame for syscall kernel-stack dispatch"
	default n
	depends on ARMV8M_SYSCALL_KERNEL_STACK && ARMV8M_LAZYFPU
	---help---
		Return from the user SVC to the privileged syscall dispatcher with
		a basic integer-only exception frame on the internal syscall stack.
		The original user PSP frame is still restored on SYS_syscall_return.
		This is useful for lazy-FPU protected syscalls when the dispatcher
		does not need the user's volatile FP frame on its internal stack.

config ARMV8M_SYSCALL_KERNEL_STACK_PSP
	bool "Run syscall kernel-stack dispatch through PSP"
	default n
	depends on ARMV8M_SYSCALL_KERNEL_STACK
	---help---
		Use PSP, not MSP, while running the privileged syscall dispatcher on
		the per-thread internal kernel stack.  This keeps handler-mode MSP on
		the normal interrupt stack after SYS_syscall_return restores the
		original user PSP frame.

config ARMV8M_HAVE_ITCM
	bool
	default n

config ARMV8M_HAVE_DTCM
	bool
	default n

config ARMV8M_ITCM
	bool "Use ITCM"
	default n
	depends on ARMV8M_HAVE_ITCM

config ARMV8M_DTCM
	bool "Use DTCM"
	default n
	depends on ARMV8M_HAVE_DTCM

config ARMV8M_TARGET2_PREL
	bool "R_ARM_TARGET2 is PC relative"
	default CXX_EXCEPTION
	depends on LIBC_ARCH_ELF
	---help---
		Perform a PC relative relocation for relocation type R_ARM_TARGET2

choice
	prompt "Select the stack protection Schema"
	default ARMV8M_STACKCHECK_HARDWARE if DEBUG_FEATURES
	default ARMV8M_STACKCHECK_NONE

config ARMV8M_STACKCHECK_NONE
	bool "Do not check for stack overflow"

config ARMV8M_STACKCHECK
	bool "Check for stack overflow on each function call"
	---help---
		This check uses R10 to check for a stack overflow within each
		function call. This has performances and code size impacts, but it
		will be able to catch hard to find stack overflows.

		Currently only available only for the STM32, SAM3/4 and SAMA5D
		architectures.  The changes are not complex and patches for
		other architectures will be accepted.

		This option requires that you are using a GCC toolchain and that
		you also include -finstrument-functions in your CFLAGS when you
		compile.  This addition to your CFLAGS should probably be added
		to the definition of the CFFLAGS in your board Make.defs file.

config ARMV8M_STACKCHECK_HARDWARE
	bool "Check for stack overflow by stack pointer limit register"
	---help---
		This option signifies the CPU has the MSPLIM, PSPLIM registers.

		The stack pointer limit registers, MSPLIM, PSPLIM, limit the
		extend to which the Main and Process Stack Pointers, respectively,
		can descend. MSPLIM, PSPLIM are always present in ARMv8-M
		MCUs that implement the ARMv8-M Main Extension (Mainline).

		In an ARMv8-M Mainline implementation with the Security Extension
		the MSPLIM, PSPLIM registers have additional Secure instances.
		In an ARMv8-M Baseline implementation with the Security Extension
		the MSPLIM, PSPLIM registers have only Secure instances.

endchoice

config ARMV8M_STACKCHECK_BREAKPOINT
	bool "Breakpoint on stack overflow"
	default n
	depends on ARMV8M_STACKCHECK
	---help---
		If enabled, a hard-coded breakpoint will be inserted to the stack
		overflow trap. This is useful to stop the execution of the program
		and diagnose the issue before the hardfault handler is called (and
		context information is lost).

config ARMV8M_ITMSYSLOG
	bool "ITM SYSLOG support"
	default n
	select SYSLOG_REGISTER
	---help---
		Enable hooks to support ITM syslog output.  This requires additional
		MCU support in order to be used.  See arch/arm/src/armv8-m/itm_syslog.h
		for additional initialization information.

if ARMV8M_ITMSYSLOG

config ARMV8M_ITMSYSLOG_PORT
	int "ITM SYSLOG Port"
	default 0
	range 0 31

config ARMV8M_ITMSYSLOG_SWODIV
	int "ITM SYSLOG SWO divider"
	default 15
	range 1 8192

endif # ARMV8M_ITMSYSLOG

config ARMV8M_SYSTICK
	bool "SysTick timer driver"
	depends on TIMER
	---help---
		Enable SysTick timer driver.

config ARMV8M_TRUSTZONE_HYBRID
	bool "Hybrid with secure and non-secure."
	default n
	depends on SMP
	---help---
		Enable the hybrid with secure and non-secure domain.
		In SMP mode, you can enable this configuration when one
		core supports secure and the other does not.

config ARMV8M_TRUSTZONE_CPU_BITMASK
	hex "Security support bitmap for multicore."
	depends on ARMV8M_TRUSTZONE_HYBRID
	default 0
	---help---
		Set Security bitmap for multicore, bit 0 means core 0.

config ARMV8M_CMSE
	bool "ARMv8-M Security Extensions"
	---help---
		Enable ARMv8-M Security Extensions.
```

## arch/arm/src/ra8p/Kconfig
```kconfig
#
# For a description of the syntax of this configuration file,
# see the file kconfig-language.txt in the NuttX tools repository.
#

comment "RA8P Configuration Options"

choice
	prompt "RA8P Chip Selection"
	default ARCH_CHIP_R7KA8P1KFLCAC
	depends on ARCH_CHIP_RA8P

config ARCH_CHIP_R7KA8P1KFLCAC
	bool "R7KA8P1KFLCAC"
	select RA8P1_FAMILY
	select RA8P_HAVE_MRAM
	select RA8P_HAVE_OSPI_B
	select RA8P_HAVE_SDRAM
	select RA8P_HAVE_SCI_UART
	select RA8P_HAVE_GPT

endchoice # RA8P Chip Selection

config RA8P1_FAMILY
	bool
	default n
	select ARCH_CORTEXM85
	select ARCH_HAVE_FPU

menu "RA8P Peripheral Support"

config RA8P_HAVE_MRAM
	bool
	default n

config RA8P_HAVE_OSPI_B
	bool
	default n

config RA8P_HAVE_SDRAM
	bool
	default n

config RA8P_HAVE_SCI_UART
	bool
	default n

config RA8P_HAVE_GPT
	bool
	default n

config RA8P_OSPI_B
	bool "OSPI_B controller"
	default n
	depends on RA8P_HAVE_OSPI_B
	---help---
		Enable the RA8P OSPI_B controller.  The EK-RA8P1 bring-up uses this
		for the Macronix MX25LW51245G external NOR on OSPI0 CS1.

config RA8P_SDRAM
	bool "External SDRAM controller"
	default n
	depends on RA8P_HAVE_SDRAM
	---help---
		Enable the RA8P external SDRAM controller.  The EK-RA8P1 exposes this
		memory at 0x68000000.

endmenu
```

## arch/arm/src/stm32h7rs/Kconfig
```kconfig
#
# For a description of the syntax of this configuration file,
# see the file kconfig-language.txt in the NuttX tools repository.
#

if ARCH_CHIP_STM32H7RS

comment "STM32H7RS Configuration Options"

choice
	prompt "STM32H7RS Chip Selection"
	default ARCH_CHIP_STM32H7S7L8
	depends on ARCH_CHIP_STM32H7RS

config ARCH_CHIP_STM32H7S7L8
	bool "STM32H7S7L8"
	select ARCH_CORTEXM7
	select ARMV7M_HAVE_ICACHE
	select ARMV7M_HAVE_DCACHE
	select ARMV7M_HAVE_ITCM
	select ARMV7M_HAVE_DTCM
	select ARMV7M_HAVE_STACKCHECK
	select STM32H7RS_STM32H7S7XX
	select STM32H7RS_FLASH_CONFIG_8
	---help---
		STM32H7RS Cortex-M7, 64 KiB internal FLASH, 456 KiB AXI SRAM.
		This is the device used by STM32H7S78-DK.

endchoice # STM32H7RS Chip Selection

config STM32H7RS_STM32H7S7XX
	bool
	default n
	select ARCH_HAVE_FPU

config STM32H7RS_FLASH_CONFIG_8
	bool
	default n

menu "STM32H7RS Peripheral Selection"

config STM32H7RS_USART
	bool "USART"
	default n
	---help---
		Enable STM32H7RS USART register and clock support.

config STM32H7RS_UART4_SERIALDRIVER
	bool "UART4 serial driver"
	default n
	depends on STM32H7RS_USART
	select UART4_SERIALDRIVER
	---help---
		Enable the STM32H7RS UART4 NuttX serial lower-half.  The
		STM32H7S78-DK uses UART4 on PD1/PD0 for its default console.

config STM32H7RS_GPIO
	bool "GPIO"
	default n
	---help---
		Enable STM32H7RS GPIO register and pin configuration support.

config STM32H7RS_XSPI
	bool "XSPI"
	default n
	---help---
		Enable STM32H7RS XSPI support for memory-mapped external
		flash and PSRAM.

config STM32H7RS_I2C
	bool "I2C"
	default n
	---help---
		Enable the STM32H7RS polling I2C master lower-half.

config STM32H7RS_I2C1
	bool "I2C1"
	default n
	depends on STM32H7RS_I2C
	---help---
		Enable I2C1.  The STM32H7S78-DK routes GT911 touch through PB6
		SCL and PB9 SDA.

config STM32H7RS_SPI
	bool "SPI"
	default n
	depends on SPI
	---help---
		Enable the STM32H7RS polling SPI master lower-half.

config STM32H7RS_SPI4
	bool "SPI4"
	default n
	depends on STM32H7RS_SPI
	---help---
		Enable SPI4.  On STM32H7S78-DK this is routed to the Arduino
		SPI header using PE12 SCK, PE13 MISO and PE14 MOSI.

config STM32H7RS_DISPLAY
	bool "LTDC display"
	default n
	---help---
		Enable the STM32H7RS LTDC framebuffer lower-half.

config STM32H7RS_GPU2D
	bool "GPU2D"
	default n
	---help---
		Enable the STM32H7RS GPU2D/NemaP command-list backend.

config STM32H7RS_LTDC_FB_DOUBLE_BUFFER
	bool "LTDC double framebuffer"
	default n
	depends on STM32H7RS_DISPLAY
	---help---
		Expose two vertically stacked framebuffer pages so LVGL's NuttX
		fbdev driver can use DIRECT render mode and FBIOPAN_DISPLAY.

endmenu # STM32H7RS Peripheral Selection

endif # ARCH_CHIP_STM32H7RS
```
