## boards/arm/stm32h7rs/stm32h7s78-dk/configs/nsh/defconfig
```kconfig
#
# This is an initial STM32H7S78-DK bring-up configuration placeholder.
# It is not expected to link until the STM32H7RS chip layer is ported.
#

CONFIG_ARCH="arm"
CONFIG_ARCH_BOARD="stm32h7s78-dk"
CONFIG_ARCH_BOARD_STM32H7S78_DK=y
CONFIG_ARCH_CHIP="stm32h7rs"
CONFIG_ARCH_CHIP_STM32H7RS=y
CONFIG_ARCH_CHIP_STM32H7S7L8=y
CONFIG_ARCH_STACKDUMP=y
CONFIG_BOARD_LATE_INITIALIZE=y
CONFIG_BOARD_LOOPSPERMSEC=60000
CONFIG_BUILTIN=y
CONFIG_INIT_ENTRYPOINT="nsh_main"
CONFIG_INTELHEX_BINARY=y
CONFIG_LIBC_FLOATINGPOINT=y
CONFIG_LIBC_STRERROR=y
CONFIG_NSH_ARCHINIT=y
CONFIG_NSH_BUILTIN_APPS=y
CONFIG_NSH_FILEIOSIZE=512
CONFIG_NSH_READLINE=y
CONFIG_PREALLOC_TIMERS=4
CONFIG_RAM_SIZE=466944
CONFIG_RAM_START=0x24000000
CONFIG_RAW_BINARY=y
CONFIG_RR_INTERVAL=200
CONFIG_SCHED_HPWORK=y
CONFIG_SCHED_LPWORK=y
CONFIG_START_DAY=6
CONFIG_START_MONTH=12
CONFIG_START_YEAR=2011
CONFIG_SYSTEM_NSH=y
CONFIG_TASK_NAME_SIZE=0
CONFIG_USER_ENTRYPOINT="nsh_main"
```

## boards/arm/stm32h7rs/stm32h7s78-dk/configs/nxboot-loader/defconfig
```kconfig
CONFIG_ARCH="arm"
CONFIG_ARCH_BOARD="stm32h7s78-dk"
CONFIG_ARCH_BOARD_STM32H7S78_DK=y
CONFIG_ARCH_CHIP="stm32h7rs"
CONFIG_ARCH_CHIP_STM32H7RS=y
CONFIG_ARCH_CHIP_STM32H7S7L8=y
# CONFIG_ARCH_FPU is not set
CONFIG_ARCH_INTERRUPTSTACK=2048
CONFIG_ARCH_STACKDUMP=y
CONFIG_BOARDCTL_BOOT_IMAGE=y
CONFIG_BOARD_LATE_INITIALIZE=y
CONFIG_BOARD_LOOPSPERMSEC=60000
CONFIG_BOOT_NXBOOT=y
CONFIG_BUILTIN=y
CONFIG_INIT_ENTRYPOINT="nxboot_loader_main"
CONFIG_INTELHEX_BINARY=y
CONFIG_LINE_MAX=64
CONFIG_MTD=y
CONFIG_NXBOOT_BOOTLOADER=y
CONFIG_NXBOOT_HEADER_SIZE=0x400
CONFIG_NXBOOT_PLATFORM_IDENTIFIER=0x48735378
CONFIG_PREALLOC_TIMERS=4
CONFIG_RAM_SIZE=466944
CONFIG_RAM_START=0x24000000
CONFIG_RAW_BINARY=y
CONFIG_RR_INTERVAL=200
CONFIG_SCHED_HPWORK=y
CONFIG_SCHED_LPWORK=y
CONFIG_SCHED_WAITPID=y
CONFIG_START_DAY=6
CONFIG_START_MONTH=5
CONFIG_START_YEAR=2026
CONFIG_STM32H7RS_APP_FORMAT_NXBOOT=y
CONFIG_STM32H7RS_EXTNOR_OTA_PARTITION=y
CONFIG_STM32H7RS_GPIO=y
CONFIG_STM32H7RS_OTA_SECONDARY_SLOT_OFFSET=0x02000000
CONFIG_STM32H7RS_OTA_SLOT_SIZE=0x02000000
CONFIG_STM32H7RS_OTA_TERTIARY_SLOT_OFFSET=0x04000000
CONFIG_STM32H7RS_USART=y
CONFIG_STM32H7RS_XSPI=y
CONFIG_UART4_SERIAL_CONSOLE=y
```

## boards/arm/stm32n6/stm32n6570-dk/Kconfig
```kconfig
#
# For a description of the syntax of this configuration file,
# see the file kconfig-language.txt in the NuttX tools repository.
#

if ARCH_BOARD_STM32N6570_DK

comment "STM32N6570-DK Board Options"

config STM32N6570_DK_NXBOOT_IMAGE
	bool "Build as BootROM-loaded NXboot payload"
	default n
	depends on NXBOOT_BOOTLOADER

config STM32N6_APP_FORMAT_NXBOOT
	bool "NXboot application image format"
	default n
	depends on STM32N6_XSPI
	select BOARDCTL_BOOT_IMAGE
	---help---
		Build an image managed by NXboot.  STM32N6570-DK places the
		NXboot payload in internal SRAM and XIP applications after an
		NXboot header in XSPI2 NOR.

config STM32N6_EXTNOR_OTA_PARTITION
	bool "Create OTA partitions on external NOR"
	default n
	depends on STM32N6_APP_FORMAT_NXBOOT
	select MTD
	select MTD_PARTITION
	---help---
		Register /dev/ota0, /dev/ota1 and /dev/ota2 from the
		STM32N6570-DK XSPI2 NOR MTD.  The first slot starts at
		0x70100000 because 0x70000000..0x700fffff is reserved for the
		BootROM header plus NXboot payload.

config STM32N6_EXTNOR_WRITE
	bool "Enable external NOR write/erase operations"
	default n
	depends on STM32N6_XSPI
	---help---
		Expose MX66UW1G45G erase and page program support through the
		STM32N6570-DK external NOR MTD.  Boot code never performs automatic
		write or erase; operations are only triggered by explicit file
		system or user commands.

config STM32N6_PSRAM_HEAP
	bool "Use XSPI1 PSRAM as an extra heap region"
	default n
	depends on STM32N6_XSPI && !NXBOOT_BOOTLOADER
	---help---
		App-side switch for adding STM32N6570-DK XSPI1 PSRAM at
		0x90000000 to the NuttX heap.  The heap starts after
		STM32N6_PSRAM_HEAP_OFFSET and extends to the end of PSRAM.

config STM32N6_PSRAM_HEAP_OFFSET
	hex "XSPI1 PSRAM heap offset"
	default 0x00200000 if STM32N6570_DK_LCD
	default 0x0 if BUILD_PROTECTED
	default 0x00200000
	depends on STM32N6_PSRAM_HEAP
	---help---
		Offset from 0x90000000 where the app-side PSRAM heap begins.
		LCD-enabled configurations keep the first 2 MiB free for the
		double-buffered framebuffer.  Non-LCD protected KNSh configurations
		use offset 0 when PSRAM is added as the secondary user heap region.
		LCD-enabled flat and protected configurations keep the first 2 MiB
		free for the framebuffer or early bring-up region.

config STM32N6_PROTECTED_USRAM_BASE
	hex "Protected build user SRAM base"
	default 0x341e0000
	depends on BUILD_PROTECTED
	---help---
		Base of the small internal SRAM window reserved for the protected
		build user blob .data/.bss sections.  The remaining internal SRAM
		below this address is available to the kernel heap.

config STM32N6_PROTECTED_USRAM_SIZE
	hex "Protected build user SRAM size"
	default 0x20000
	depends on BUILD_PROTECTED
	---help---
		Size of the protected build internal SRAM window reserved for user
		.data/.bss.  STM32N6570-DK currently gives the top 128 KiB of the
		2 MiB app SRAM window to user static data and leaves the rest of
		internal SRAM for kernel sections and kernel heap.

config STM32N6_PROTECTED_UHEAP_SIZE
	hex "Protected build bootstrap user heap size"
	default 0x2000 if STM32N6_PSRAM_HEAP && MM_KERNEL_HEAP
	default 0x0
	depends on BUILD_PROTECTED
	---help---
		Size of the initial protected user heap reserved inside the
		internal user SRAM window.  STM32N6570-DK protected builds keep
		the allocator control structure and earliest user allocations in
		internal SRAM, then add XSPI1 PSRAM later as an extra user heap
		region.  LCD/LVGL validation builds may raise this value to keep
		more hot UI allocations internal before the PSRAM heap is used.

config STM32N6570_DK_LCD
	bool "RK050HR18 RGB LCD framebuffer"
	default n
	depends on STM32N6_XSPI
	select DRIVERS_VIDEO
	select VIDEO_FB
	select FB_UPDATE
	select FB_SYNC
	select STM32N6_GPIO
	select STM32N6_DISPLAY
	select STM32N6_LTDC_FB_DOUBLE_BUFFER
	---help---
		Enable the STM32N6570-DK 800x480 RK050HR18 RGB panel through
		the LTDC block and expose it as /dev/fb0.  The double-buffered
		RGB565 framebuffer is placed at the start of XSPI1 PSRAM.

config STM32N6570_DK_GT911
	bool "GT911 touchscreen"
	default n
	depends on STM32N6570_DK_LCD
	select INPUT
	select INPUT_GT911
	select STM32N6_GPIO
	select STM32N6_I2C
	select STM32N6_I2C2
	---help---
		Enable the Goodix GT911 touchscreen on /dev/input0.  The DK
		wires GT911 to the LCD connector I2C2 pins (PD14 SCL, PD4 SDA)
		and PE1/PQ4 for reset/interrupt, matching the STM32CubeN6 DK BSP.

config STM32N6570_DK_GT911_POLL_MS
	int "GT911 poll interval in milliseconds"
	default 30
	depends on STM32N6570_DK_GT911

config STM32N6570_DK_GT911_DEBUG
	bool "GT911 touchscreen bring-up logs"
	default n
	depends on STM32N6570_DK_GT911
	select INPUT_GT911_DEBUG

if STM32N6_EXTNOR_OTA_PARTITION

config STM32N6_OTA_PRIMARY_SLOT_DEVPATH
	string "Primary image slot devpath"
	default "/dev/ota0"

config STM32N6_OTA_SECONDARY_SLOT_DEVPATH
	string "Secondary image slot devpath"
	default "/dev/ota1"

config STM32N6_OTA_TERTIARY_SLOT_DEVPATH
	string "Tertiary image slot devpath"
	default "/dev/ota2"

config STM32N6_OTA_PRIMARY_SLOT_OFFSET
	hex "Primary image slot offset in external NOR"
	default 0x00100000

config STM32N6_OTA_SECONDARY_SLOT_OFFSET
	hex "Secondary image slot offset in external NOR"
	default 0x02100000

config STM32N6_OTA_TERTIARY_SLOT_OFFSET
	hex "Tertiary image slot offset in external NOR"
	default 0x04100000

config STM32N6_OTA_SLOT_SIZE
	hex "Image slot size"
	default 0x02000000

endif # STM32N6_EXTNOR_OTA_PARTITION

config STM32N6570_DK_LCD_COLORBAR
	bool "Show LCD colorbar during bring-up"
	default n
	depends on STM32N6570_DK_LCD

endif # ARCH_BOARD_STM32N6570_DK
```

## boards/arm/stm32n6/stm32n6570-dk/configs/nxboot/defconfig
```kconfig
CONFIG_ARCH="arm"
CONFIG_ARCH_BOARD="stm32n6570-dk"
CONFIG_ARCH_BOARD_STM32N6570_DK=y
CONFIG_ARCH_CHIP="stm32n6"
CONFIG_ARCH_CHIP_STM32N6=y
CONFIG_ARCH_CHIP_STM32N657X0=y
CONFIG_ARCH_INTERRUPTSTACK=4096
CONFIG_ARCH_STACKDUMP=y
CONFIG_IDLETHREAD_STACKSIZE=4096
CONFIG_INIT_STACKSIZE=4096
CONFIG_ARM_MPU=y
CONFIG_ARM_MPU_NREGIONS=16
CONFIG_ARM_MPU_RESET=y
CONFIG_ARMV8M_DCACHE=y
CONFIG_ARMV8M_ICACHE=y
CONFIG_BOARDCTL_BOOT_IMAGE=y
CONFIG_BOARD_LATE_INITIALIZE=y
CONFIG_BOARD_LOOPSPERMSEC=60000
CONFIG_BOOT_NXBOOT=y
CONFIG_BUILTIN=y
CONFIG_INIT_ENTRYPOINT="nxboot_loader_main"
CONFIG_INTELHEX_BINARY=y
CONFIG_LINE_MAX=64
# CONFIG_LIBC_UNAME_DISABLE_TIMESTAMP is not set
CONFIG_MTD=y
CONFIG_NXBOOT_BOOTLOADER=y
CONFIG_NXBOOT_HEADER_SIZE=0x400
CONFIG_NXBOOT_PLATFORM_IDENTIFIER=0x4e363537
CONFIG_PREALLOC_TIMERS=4
CONFIG_RAM_SIZE=523264
CONFIG_RAM_START=0x34180400
CONFIG_RAW_BINARY=y
CONFIG_RR_INTERVAL=200
CONFIG_SCHED_HPWORK=y
CONFIG_SCHED_LPWORK=y
CONFIG_SCHED_WAITPID=y
CONFIG_START_DAY=7
CONFIG_START_MONTH=5
CONFIG_START_YEAR=2026
CONFIG_STM32N6570_DK_NXBOOT_IMAGE=y
CONFIG_STM32N6_APP_FORMAT_NXBOOT=y
CONFIG_STM32N6_EXTNOR_OTA_PARTITION=y
CONFIG_STM32N6_GPIO=y
CONFIG_STM32N6_OTA_PRIMARY_SLOT_OFFSET=0x00100000
CONFIG_STM32N6_OTA_SECONDARY_SLOT_OFFSET=0x02100000
CONFIG_STM32N6_OTA_SLOT_SIZE=0x02000000
CONFIG_STM32N6_OTA_TERTIARY_SLOT_OFFSET=0x04100000
CONFIG_STM32N6_USART=y
CONFIG_STM32N6_USART1=y
CONFIG_STM32N6_XSPI=y
```
