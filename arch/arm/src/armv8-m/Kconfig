## arch/arm/src/stm32n6/Kconfig
```kconfig
# arch/arm/src/stm32n6/Kconfig
#
# SPDX-License-Identifier: Apache-2.0
#
# Licensed to the Apache Software Foundation (ASF) under one or more
# contributor license agreements.  See the NOTICE file distributed with
# this work for additional information regarding copyright ownership.  The
# ASF licenses this file to you under the Apache License, Version 2.0 (the
# "License"); you may not use this file except in compliance with the
# License.  You may obtain a copy of the License at
#
#   http://www.apache.org/licenses/LICENSE-2.0
#
# Unless required by applicable law or agreed to in writing, software
# distributed under the License is distributed on an "AS IS" BASIS, WITHOUT
# WARRANTIES OR CONDITIONS OF ANY KIND, either express or implied.  See the
# License for the specific language governing permissions and limitations
# under the License.

if ARCH_CHIP_STM32N6

comment "STM32N6 Configuration Options"

config STM32N6_STM32N6XXXX
	bool
	default y

choice
	prompt "STM32 N6 Chip Selection"
	default ARCH_CHIP_STM32N657X0
	depends on ARCH_CHIP_STM32N6

config ARCH_CHIP_STM32N657X0
	bool "STM32N657X0"
	select STM32N6_STM32N6XXXX
	select ARCH_HAVE_RAMFUNCS
	select ARMV8M_HAVE_DCACHE
	select ARMV8M_HAVE_ICACHE
	---help---
		STM32N657 Cortex-M55 part used by STM32N6570-DK and
		NUCLEO-N657X0-Q.

endchoice

menu "STM32N6 Peripheral Selection"

config STM32N6_GPIO
	bool "GPIO"
	default n

config STM32N6_USART1
	bool "USART1"
	default n
	select STM32N6_USART
	select STM32N6_USART1_SERIALDRIVER
	select USART1_SERIALDRIVER

config STM32N6_USART
	bool "USART"
	default n

if STM32N6_USART

config STM32N6_USART1_SERIALDRIVER
	bool "USART1 serial driver"
	default n
	select ARCH_HAVE_SERIAL_TERMIOS
	select USART1_SERIALDRIVER
	---help---
		Enable the STM32N657 USART1 lower-half.

config STM32N6_SERIAL_DISABLE_REORDERING
	bool "Disable reordering of ttySx devices."
	depends on STM32N6_USART1
	default n
	---help---
		NuttX per default reorders the serial ports (/dev/ttySx) so that the
		console is always on /dev/ttyS0. If more than one UART is in use this
		can, however, have the side-effect that all port mappings
		(hardware USART1 -> /dev/ttyS0) change if the console is moved to
		another UART. This option disables that reordering so port names
		stay stable when the console is moved.

config STM32N6_FLOWCONTROL_BROKEN
	bool "Use Software UART RTS flow control"
	default n
	---help---
		Enable this option to use software RTS flow control rather than
		the hardware RTS line.  Useful in cases where the silicon RTS
		behaviour does not match the application's needs.

config STM32N6_SERIALBRK_BSDCOMPAT
	bool "Use GPIO to send Break"
	default n
	---help---
		Enable this option to send break by reconfiguring TX as a GPIO
		held low for the requested duration, matching BSD-compatible
		semantics.

config STM32N6_PM_SERIAL_ACTIVITY
	int "PM serial activity"
	default 10
	---help---
		PM activity reported to power management logic on every serial
		interrupt.

endif # STM32N6_USART

if USART1_SERIALDRIVER

config USART1_RXBUFSIZE
	int "USART1 receive buffer size"
	default 256

config USART1_TXBUFSIZE
	int "USART1 transmit buffer size"
	default 256

config USART1_UNCONFIG_RX_ON_CLOSE
	bool "Unconfigure USART1 RX pin on close"
	default n
	depends on STM32N6_USART1

config USART1_UNCONFIG_TX_ON_CLOSE
	bool "Unconfigure USART1 TX pin on close"
	default n
	depends on STM32N6_USART1

config STM32N6_USART1_TX_POLL_DRAIN
	bool "Drain USART1 TX buffer by polling"
	default n
	---help---
		Diagnostic option for early STM32N6 protected-mode bring-up.  When
		enabled, USART1 drains the software TX buffer synchronously when TX
		interrupts are enabled, instead of depending on later TXE/TXFNF
		interrupts to continue moving console output.

config STM32N6_USART1_HIGH_PRIORITY
	bool "Run USART1 at high IRQ priority"
	default n
	select ARCH_IRQPRIO
	---help---
		Diagnostic option for early STM32N6 protected-mode bring-up.  When
		enabled, USART1 uses NVIC_SYSH_HIGH_PRIORITY so console TX/RX IRQs
		are not masked by the normal BASEPRI critical-section threshold.

endif # USART1_SERIALDRIVER

config STM32N6_XSPI
	bool "XSPI"
	default n

config STM32N6_SDMMC
	bool "SDMMC"
	default n

config STM32N6_DISPLAY
	bool "Display controller block"
	default n

config STM32N6_GPU2D
	bool "GPU2D/NemaP"
	default n
	---help---
		Enable the STM32N6 GPU2D/NemaP low-level register and
		command-list backend.

config STM32N6_LTDC_FB_DOUBLE_BUFFER
	bool "LTDC framebuffer double buffering"
	default n
	depends on STM32N6_DISPLAY
	---help---
		Expose two screen-sized framebuffer pages through the NuttX
		framebuffer interface and switch the LTDC scanout address with
		FBIOPAN_DISPLAY.

config STM32N6_I2C
	bool "I2C"
	default n

config STM32N6_I2C2
	bool "I2C2"
	default n
	depends on STM32N6_I2C

config STM32N6_I2CTIMEO
	int "I2C poll timeout"
	default 2000000
	depends on STM32N6_I2C

config STM32N6_I2C2_TIMING
	hex "I2C2 TIMINGR value"
	default 0xe0b03c3d
	depends on STM32N6_I2C2
	---help---
		TIMINGR used by the minimal STM32N6 I2C2 master driver.
		The default matches the STM32CubeN6 timing algorithm for a
		200 MHz PCLK1 source and 100 kHz standard-mode bus.

endmenu

menu "STM32N6 Memory Attribute Configuration"

choice
	prompt "XSPI1 PSRAM MPU shareability"
	default STM32N6_PSRAM_MPU_SHARE_NONE
	depends on ARM_MPU
	---help---
		Select the ARMv8-M MPU shareability attribute used for the
		STM32N6 XSPI1 PSRAM memory-mapped window.  Cortex-M55 treats
		Shareable data transactions as Non-cacheable for the L1 data
		cache, so CPU-owned PSRAM heap and stack traffic must be mapped
		Non-shareable to benefit from the write-back cache policy.  PSRAM
		ranges shared with LTDC, DMA, or other bus masters still require
		explicit cache maintenance or a non-cacheable MPU override.

config STM32N6_PSRAM_MPU_SHARE_OUTER
	bool "Outer shareable"

config STM32N6_PSRAM_MPU_SHARE_NONE
	bool "Non-shareable"

endchoice

choice
	prompt "XSPI1 PSRAM MPU cache policy"
	default STM32N6_PSRAM_MPU_WRITE_BACK
	depends on ARM_MPU
	---help---
		Select the ARMv8-M MAIR cache attribute used for the STM32N6
		XSPI1 PSRAM memory-mapped window.

config STM32N6_PSRAM_MPU_WRITE_BACK
	bool "Write-back cacheable"

config STM32N6_PSRAM_MPU_WRITE_THROUGH
	bool "Write-through cacheable"

config STM32N6_PSRAM_MPU_NONCACHEABLE
	bool "Non-cacheable"

endchoice

config STM32N6_PSRAM_MPU_NO_WRITE_ALLOCATE
	bool "Use no-write-allocate cacheable MAIR for PSRAM"
	default y
	depends on ARM_MPU && !STM32N6_PSRAM_MPU_NONCACHEABLE
	---help---
		Use read-allocate, no-write-allocate MAIR encodings for the
		STM32N6 XSPI1 PSRAM MPU region.  This avoids the cacheable
		write-allocate linefill path and allows non-shareable cacheable
		PSRAM to be used for CPU-owned stack and heap traffic.  PSRAM
		regions shared with LTDC, DMA, or other bus masters still require
		a non-cacheable MPU override or explicit cache maintenance.

endmenu

endif # ARCH_CHIP_STM32N6
```

## boards/arm/ra8p/ek-ra8p1/Kconfig
```kconfig
#
# For a description of the syntax of this configuration file,
# see the file kconfig-language.txt in the NuttX tools repository.
#

if ARCH_BOARD_EK_RA8P1

comment "EK-RA8P1 Board Options"

config EK_RA8P1_APP_FORMAT_NXBOOT
	bool "NXboot application image format"
	default n
	select BOARDCTL_BOOT_IMAGE
	---help---
		Build an image managed by NXboot.  The loader is linked in
		internal MRAM and applications are linked after an NXboot header in
		OSPI0 CS1 NOR.

config EK_RA8P1_EXTNOR_OTA_PARTITION
	bool "Create OTA partitions on OSPI NOR"
	default n
	depends on EK_RA8P1_APP_FORMAT_NXBOOT
	select MTD
	select MTD_PARTITION
	---help---
		Register external OSPI NOR image slots for NXboot.  The EK-RA8P1
		uses the 64 MiB MX25LW51245G device on OSPI0 CS1, split into two
		32 MiB slots.

config EK_RA8P1_SDRAM_HEAP
	bool "Use external SDRAM as heap"
	default n
	depends on RA8P_SDRAM && !NXBOOT_BOOTLOADER
	---help---
		Use external SDRAM at 0x68000000 for dynamic allocation after the
		SDRAM controller has been initialized.  In protected KNSh with a
		kernel heap this is the primary user heap; in flat builds it is
		added as an extra heap region and requires CONFIG_MM_REGIONS > 1.

config EK_RA8P1_PROTECTED_USRAM_BASE
	hex "Protected build user SRAM base"
	default 0x221b4000
	depends on BUILD_PROTECTED
	---help---
		Base of the internal SRAM window reserved for protected user-space
		.data/.bss and user stacks.  The default gives the top 128 KiB of
		RA8P1 SRAM to user-space and leaves the lower SRAM to the kernel.

config EK_RA8P1_PROTECTED_USRAM_SIZE
	hex "Protected build user SRAM size"
	default 0x20000
	depends on BUILD_PROTECTED

if EK_RA8P1_EXTNOR_OTA_PARTITION

config EK_RA8P1_OTA_PRIMARY_SLOT_DEVPATH
	string "Primary image slot devpath"
	default "/dev/ota0"

config EK_RA8P1_OTA_SECONDARY_SLOT_DEVPATH
	string "Secondary image slot devpath"
	default "/dev/ota1"

config EK_RA8P1_OTA_PRIMARY_SLOT_OFFSET
	hex "Primary image slot offset in OSPI NOR"
	default 0x00000000

config EK_RA8P1_OTA_SECONDARY_SLOT_OFFSET
	hex "Secondary image slot offset in OSPI NOR"
	default 0x02000000

config EK_RA8P1_OTA_SLOT_SIZE
	hex "Image slot size"
	default 0x02000000

endif # EK_RA8P1_EXTNOR_OTA_PARTITION

endif # ARCH_BOARD_EK_RA8P1
```

## boards/arm/ra8p/ek-ra8p1/configs/knsh/defconfig
```kconfig
CONFIG_ARCH="arm"
CONFIG_ARCH_BOARD="ek-ra8p1"
CONFIG_ARCH_BOARD_EK_RA8P1=y
CONFIG_ARCH_CHIP="ra8p"
CONFIG_ARCH_CHIP_R7KA8P1KFLCAC=y
CONFIG_ARCH_CHIP_RA8P=y
CONFIG_ARCH_INTERRUPTSTACK=2048
CONFIG_ARCH_STACKDUMP=y
CONFIG_ARMV8M_SYSTICK=y
CONFIG_ARM_MPU=y
CONFIG_ARM_MPU_NREGIONS=16
CONFIG_ARM_MPU_RESET=y
CONFIG_BOARD_LATE_INITIALIZE=y
CONFIG_BOARD_LOOPSPERMSEC=1000000
CONFIG_BOOT_NXBOOT=y
CONFIG_BUILD_PROTECTED=y
CONFIG_BUILTIN=y
CONFIG_DEBUG_BUSFAULT=y
CONFIG_DEBUG_FEATURES=y
CONFIG_DEBUG_HARDFAULT_ALERT=y
CONFIG_DEBUG_MEMFAULT=y
CONFIG_DEBUG_USAGEFAULT=y
CONFIG_EK_RA8P1_APP_FORMAT_NXBOOT=y
CONFIG_EK_RA8P1_EXTNOR_OTA_PARTITION=y
CONFIG_EK_RA8P1_OTA_SECONDARY_SLOT_OFFSET=0x02000000
CONFIG_EK_RA8P1_OTA_SLOT_SIZE=0x02000000
CONFIG_EK_RA8P1_PROTECTED_USRAM_BASE=0x221b4000
CONFIG_EK_RA8P1_PROTECTED_USRAM_SIZE=0x20000
CONFIG_EK_RA8P1_SDRAM_HEAP=y
CONFIG_FS_PROCFS=y
CONFIG_FS_PROCFS_REGISTER=y
CONFIG_INIT_ENTRYPOINT="nsh_main"
CONFIG_INTELHEX_BINARY=y
CONFIG_LIBC_STRERROR=y
CONFIG_MM_KERNEL_HEAP=y
CONFIG_MTD=y
CONFIG_NSH_ARCHINIT=y
CONFIG_NSH_BUILTIN_APPS=y
CONFIG_NSH_DISABLE_IFUPDOWN=y
CONFIG_NSH_FILEIOSIZE=512
CONFIG_NSH_READLINE=y
CONFIG_NUTTX_USERSPACE=0x90080400
CONFIG_NXBOOT_HEADER_SIZE=0x400
CONFIG_NXBOOT_PLATFORM_IDENTIFIER=0x52413850
CONFIG_PASS1_BUILDIR="boards/arm/ra8p/ek-ra8p1/kernel"
CONFIG_PREALLOC_TIMERS=4
CONFIG_RA8P_OSPI_B=y
CONFIG_RA8P_SDRAM=y
CONFIG_RAM_SIZE=1916928
CONFIG_RAM_START=0x22000000
CONFIG_RAW_BINARY=y
CONFIG_RR_INTERVAL=200
CONFIG_SCHED_WAITPID=y
CONFIG_START_DAY=15
CONFIG_START_MONTH=5
CONFIG_START_YEAR=2026
CONFIG_SYSTEM_NSH=y
CONFIG_TIMER=y
CONFIG_USER_ENTRYPOINT="nsh_main"
```
