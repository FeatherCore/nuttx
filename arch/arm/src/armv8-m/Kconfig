## boards/arm/stm32h7rs/stm32h7s78-dk/Kconfig
```kconfig
#
# For a description of the syntax of this configuration file,
# see the file kconfig-language.txt in the NuttX tools repository.
#

if ARCH_BOARD_STM32H7S78_DK

comment "STM32H7S78-DK Board Options"

config STM32H7RS_APP_FORMAT_NXBOOT
	bool "NXboot application image format"
	default n
	depends on STM32H7RS_XSPI
	select BOARDCTL_BOOT_IMAGE
	---help---
		Build an image intended to be managed by NXboot.  The board linker
		scripts place the loader in internal Flash and the application after
		an NXboot header in memory-mapped XSPI2 NOR.

config STM32H7RS_EXTNOR_OTA_PARTITION
	bool "Create OTA partitions on external NOR"
	default n
	depends on STM32H7RS_APP_FORMAT_NXBOOT
	select MTD
	select MTD_PARTITION
	---help---
		Register /dev/ota0, /dev/ota1 and /dev/ota2 from the
		STM32H7S78-DK XSPI2 NOR MTD.  Keep the partition table in
		Kconfig so NXboot slot geometry and board registration stay in
		sync.

config STM32H7RS_PSRAM_HEAP
	bool "Use XSPI1 PSRAM as an extra heap region"
	default n
	depends on STM32H7RS_XSPI && !NXBOOT_BOOTLOADER
	---help---
		Add the STM32H7S78-DK XSPI1 PSRAM at 0x90000000 to the NuttX heap
		from the board-specific arm_addregion() implementation.

config STM32H7RS_PSRAM_HEAP_OFFSET
	hex "XSPI1 PSRAM heap offset"
	default 0x00200000 if STM32H7S78_DK_LCD
	default 0x0
	depends on STM32H7RS_PSRAM_HEAP
	---help---
		Reserve the first bytes of the memory-mapped XSPI1 PSRAM window
		before adding the remaining range to the NuttX heap.  LCD-enabled
		configurations keep this area for the double-buffered framebuffer
		without overlapping malloc metadata or user allocations.

config STM32H7RS_PROTECTED_USRAM_BASE
	hex "Protected build user SRAM base"
	default 0x24060000
	depends on BUILD_PROTECTED
	---help---
		Base of the small internal SRAM window reserved for the protected
		build user blob .data/.bss sections.  The remaining internal SRAM
		below this address is available to the kernel heap.

config STM32H7RS_PROTECTED_USRAM_SIZE
	hex "Protected build user SRAM size"
	default 0x12000
	depends on BUILD_PROTECTED
	---help---
		Size of the protected build internal SRAM window reserved for user
		.data/.bss.  STM32H7S78-DK has 456 KiB AXI SRAM, so the default
		0x24060000..0x24071fff reserves 72 KiB for user static data and
		leaves the rest of internal SRAM for kernel state and kernel heap.

config STM32H7S78_DK_LCD
	bool "RK050HR18 RGB LCD framebuffer"
	default n
	depends on STM32H7RS_XSPI
	select DRIVERS_VIDEO
	select VIDEO_FB
	select FB_UPDATE
	select FB_SYNC
	select STM32H7RS_GPIO
	select STM32H7RS_DISPLAY
	select STM32H7RS_LTDC_FB_DOUBLE_BUFFER
	---help---
		Enable the STM32H7S78-DK 800x480 RK050HR18 RGB LCD through LTDC
		and expose the double-buffered RGB565 framebuffer as /dev/fb0.
		The framebuffer is placed at the start of XSPI1 PSRAM.

config STM32H7S78_DK_GT911
	bool "GT911 touchscreen"
	default n
	depends on STM32H7S78_DK_LCD
	select INPUT
	select INPUT_GT911
	select STM32H7RS_I2C
	select STM32H7RS_I2C1
	---help---
		Enable the Goodix GT911 touchscreen on /dev/input0.  The
		STM32H7S78-DK routes the touch controller through I2C1
		(PB6/PB9), matching the STM32CubeH7RS DK BSP.

config STM32H7S78_DK_GT911_POLL_MS
	int "GT911 poll interval in milliseconds"
	default 30
	depends on STM32H7S78_DK_GT911

config STM32H7S78_DK_GT911_DEBUG
	bool "GT911 touchscreen debug logs"
	default n
	depends on STM32H7S78_DK_GT911
	select INPUT_GT911_DEBUG

config STM32H7S78_DK_AW8697
	bool "AW8697 haptic motor"
	default n
	select INPUT
	select INPUT_FF
	select FF_AW8697
	select STM32H7RS_I2C
	select STM32H7RS_I2C1
	---help---
		Enable the AWINIC AW8697 LRA haptic driver and register it as a
		NuttX force-feedback input device.  The LD0832AA-0126F motor under
		third/HW/motor is rated for 235 Hz, which is the default driver
		RTP frequency.  The default board wiring uses the ARDUINO Uno V3
		I2C pins D15/CN14 pin 10/PB6 for SCL and D14/CN14 pin 9/PB9 for
		SDA.  The AW8697 interrupt output is reserved on D3/CN14 pin 4/PD12,
		and RSTN is driven from D2/CN14 pin 3/PF1.

config STM32H7S78_DK_BME280
	bool "BME280 environment sensor"
	default n
	select SENSORS
	select SENSORS_BME280
	select STM32H7RS_I2C
	select STM32H7RS_I2C1
	---help---
		Enable the Bosch BME280 temperature, humidity and pressure sensor
		on the ARDUINO Uno V3 I2C pins.  The default board wiring uses
		D15/CN14 pin 10/PB6 for SCL and D14/CN14 pin 9/PB9 for SDA.
		The BME280 address is selected by SDO: 0x76 when tied to GND and
		0x77 when tied to VDDIO.

config STM32H7S78_DK_MAX30102
	bool "MAX30102 heart-rate and SpO2 sensor"
	default n
	select SENSORS
	select SENSORS_MAX30102
	select STM32H7RS_I2C
	select STM32H7RS_I2C1
	---help---
		Enable the Maxim MAX30102 pulse oximeter and heart-rate sensor
		on the ARDUINO Uno V3 I2C pins.  The default board wiring uses
		D15/CN14 pin 10/PB6 for SCL and D14/CN14 pin 9/PB9 for SDA.
		The active-low open-drain interrupt output is reserved on
		D2/CN14 pin 3/PF1.  The MAX30102 fixed 7-bit I2C address is
		0x57.  RD and IRD are LED driver/module pins and are not wired
		to MCU GPIOs in this bring-up configuration.

config STM32H7S78_DK_LSM6DSOX
	bool "LSM6DSOX accelerometer and gyroscope"
	default n
	select SENSORS
	select SENSORS_LSM6DSOX
	select STM32H7RS_I2C
	select STM32H7RS_I2C1
	---help---
		Enable the STMicro LSM6DSOX accelerometer and gyroscope on the
		ARDUINO Uno V3 I2C pins.  The default board wiring uses
		D15/CN14 pin 10/PB6 for SCL and D14/CN14 pin 9/PB9 for SDA.
		The LSM6DSOX address is selected by SDO/SA0: 0x6a when tied
		to GND and 0x6b when tied to VDDIO.  INT1 and INT2 are not
		used by the initial polling demo.

if STM32H7RS_EXTNOR_OTA_PARTITION

config STM32H7RS_OTA_PRIMARY_SLOT_DEVPATH
	string "Primary image slot devpath"
	default "/dev/ota0"

config STM32H7RS_OTA_SECONDARY_SLOT_DEVPATH
	string "Secondary image slot devpath"
	default "/dev/ota1"

config STM32H7RS_OTA_TERTIARY_SLOT_DEVPATH
	string "Tertiary image slot devpath"
	default "/dev/ota2"

config STM32H7RS_OTA_PRIMARY_SLOT_OFFSET
	hex "Primary image slot offset in external NOR"
	default 0x0

config STM32H7RS_OTA_SECONDARY_SLOT_OFFSET
	hex "Secondary image slot offset in external NOR"
	default 0x02000000

config STM32H7RS_OTA_TERTIARY_SLOT_OFFSET
	hex "Tertiary image slot offset in external NOR"
	default 0x04000000

config STM32H7RS_OTA_SLOT_SIZE
	hex "Image slot size"
	default 0x02000000

endif # STM32H7RS_EXTNOR_OTA_PARTITION

endif # ARCH_BOARD_STM32H7S78_DK
```

## boards/arm/stm32h7rs/stm32h7s78-dk/configs/nsh-esp_hosted_ng/defconfig
```kconfig
CONFIG_ARCH="arm"
CONFIG_ARCH_BOARD="stm32h7s78-dk"
CONFIG_ARCH_BOARD_STM32H7S78_DK=y
CONFIG_ARCH_CHIP="stm32h7rs"
CONFIG_ARCH_CHIP_STM32H7RS=y
CONFIG_ARCH_CHIP_STM32H7S7L8=y
CONFIG_ARM_MPU=y
CONFIG_ARM_MPU_NREGIONS=16
CONFIG_ARM_MPU_RESET=y
CONFIG_ARMV7M_DCACHE=y
CONFIG_ARMV7M_ICACHE=y
CONFIG_ARCH_INTERRUPTSTACK=2048
CONFIG_ARCH_STACKDUMP=y
CONFIG_BOARD_LATE_INITIALIZE=y
CONFIG_BOARD_LOOPSPERMSEC=60000
CONFIG_BOOT_NXBOOT=y
CONFIG_BENCHMARK_RAMSPEED=y
CONFIG_BUILTIN=y
CONFIG_ETC_ROMFS=y
CONFIG_ETC_ROMFSDEVNO=1
CONFIG_ETC_ROMFSMOUNTPT="/etc"
CONFIG_ETC_ROMFSSECTSIZE=64
CONFIG_FS_ROMFS=y
CONFIG_INIT_ENTRYPOINT="nsh_main"
CONFIG_INIT_STACKSIZE=16384
CONFIG_INTELHEX_BINARY=y
CONFIG_LIBC_FLOATINGPOINT=y
CONFIG_LIBC_STRERROR=y
# CONFIG_LIBC_UNAME_DISABLE_TIMESTAMP is not set
CONFIG_MM_REGIONS=2
CONFIG_MTD=y
CONFIG_NSH_ARCHINIT=y
CONFIG_NSH_BUILTIN_APPS=y
CONFIG_NSH_FILEIOSIZE=512
CONFIG_NSH_PROC_MOUNTPOINT="/proc"
CONFIG_NSH_READLINE=y
# CONFIG_NSH_DISABLE_FREE is not set
# CONFIG_NSH_DISABLE_PS is not set
CONFIG_FS_PROCFS=y
CONFIG_FS_PROCFS_REGISTER=y
# CONFIG_FS_PROCFS_EXCLUDE_MEMINFO is not set
# CONFIG_FS_PROCFS_EXCLUDE_PROCESS is not set
CONFIG_DEV_URANDOM=y
CONFIG_DEV_URANDOM_XORSHIFT128=y
CONFIG_NXBOOT_HEADER_SIZE=0x400
CONFIG_NXBOOT_PLATFORM_IDENTIFIER=0x48735378
CONFIG_PREALLOC_TIMERS=4
CONFIG_RAM_SIZE=466944
CONFIG_RAM_START=0x24000000
CONFIG_RAW_BINARY=y
CONFIG_RR_INTERVAL=200
CONFIG_SCHED_HPWORK=y
CONFIG_SCHED_HPWORKSTACKSIZE=8192
CONFIG_SCHED_LPWORK=y
CONFIG_SCHED_LPWORKSTACKSIZE=8192
CONFIG_SCHED_WAITPID=y
CONFIG_DEFAULT_TASK_STACKSIZE=8192
CONFIG_PTHREAD_STACK_DEFAULT=8192
CONFIG_START_DAY=6
CONFIG_START_MONTH=5
CONFIG_START_YEAR=2026
CONFIG_STM32H7RS_APP_FORMAT_NXBOOT=y
CONFIG_STM32H7RS_EXTNOR_OTA_PARTITION=y
CONFIG_STM32H7RS_GPIO=y
CONFIG_STM32H7RS_OTA_SECONDARY_SLOT_OFFSET=0x02000000
CONFIG_STM32H7RS_OTA_SLOT_SIZE=0x02000000
CONFIG_STM32H7RS_OTA_TERTIARY_SLOT_OFFSET=0x04000000
CONFIG_STM32H7RS_PSRAM_HEAP=y
CONFIG_STM32H7RS_PSRAM_HEAP_OFFSET=0x1000
CONFIG_STM32H7RS_USART=y
CONFIG_STM32H7RS_UART4_SERIALDRIVER=y
CONFIG_STM32H7RS_SPI=y
CONFIG_STM32H7RS_SPI4=y
CONFIG_STM32H7RS_XSPI=y
CONFIG_SYSTEM_NSH=y
CONFIG_SYSTEM_NSH_STACKSIZE=16384
CONFIG_TESTING_MEMORY_STRESS=y
CONFIG_TESTING_RAMTEST=y
CONFIG_UART4_SERIAL_CONSOLE=y
CONFIG_USER_ENTRYPOINT="nsh_main"

#
# ESP32-C5 ESP-Hosted NG Wi-Fi bring-up
#
CONFIG_NET=y
CONFIG_NET_NETLINK=y
CONFIG_NETLINK_PREALLOC_CONNS=8
CONFIG_NETLINK_GENERIC=y
CONFIG_NETLINK_ROUTE=y
CONFIG_NET_PKT=y
CONFIG_NET_PKTPROTO_OPTIONS=y
CONFIG_NET_PKT_PREALLOC_CONNS=4
CONFIG_NETDEV_IFINDEX=y
CONFIG_NETDEV_LATEINIT=y
CONFIG_NETDEV_STATISTICS=y
CONFIG_NETDEV_WIRELESS_IOCTL=y
CONFIG_NET_BROADCAST=y
CONFIG_NET_ETH_PKTSIZE=1514
CONFIG_NET_ICMP_SOCKET=y
CONFIG_NET_TCP=y
CONFIG_NET_TCP_WRITE_BUFFERS=y
CONFIG_NET_UDP=y
CONFIG_NET_UDP_CHECKSUMS=y
CONFIG_NETDB_DNSCLIENT=y
CONFIG_NETDB_DNSSERVER_IPv4ADDR=0x08080808
CONFIG_NETUTILS_DHCPC=y
CONFIG_NETUTILS_IPERF=y
CONFIG_SYSTEM_PING=y
CONFIG_SYSTEM_IFCONFIG=y
CONFIG_WIRELESS=y
CONFIG_DRIVERS_WIRELESS=y
CONFIG_DRIVERS_IEEE80211=y
CONFIG_WIRELESS_IEEE80211_CFG80211_LINUX=y
# CONFIG_WIRELESS_IEEE80211_NL80211_METADATA_ONLY is not set
CONFIG_WIRELESS_ESP_HOSTED_NG=y
CONFIG_WIRELESS_ESP_HOSTED_NG_SPI=y
CONFIG_WL_ESP_HOSTED_NG=y
CONFIG_WL_ESP_HOSTED_NG_LINUX_CFG80211=y
CONFIG_WL_ESP_HOSTED_NG_SPI_DEV=4
CONFIG_WL_ESP_HOSTED_NG_SPI_FREQUENCY=10000000
CONFIG_WL_ESP_HOSTED_NG_SPI_MODE=2
CONFIG_WL_ESP_HOSTED_NG_HANDSHAKE_PIN=2
CONFIG_WL_ESP_HOSTED_NG_DATA_READY_PIN=4
CONFIG_WL_ESP_HOSTED_NG_RESET_PIN=7
CONFIG_WL_ESP_HOSTED_NG_IFNAME="wlan0"
CONFIG_WIRELESS_WIFI_PORTS=y
CONFIG_WIRELESS_WIFI_LIBNL=y
CONFIG_WIRELESS_WIFI_WPA_SUPPLICANT=y
CONFIG_WIRELESS_WIFI_WPA_SUPPLICANT_STACKSIZE=16384
CONFIG_SPI=y
CONFIG_SPI_EXCHANGE=y
```

## boards/arm/stm32h7rs/stm32h7s78-dk/configs/nsh-lsm6dsox/defconfig
```kconfig
CONFIG_ARCH="arm"
CONFIG_ARCH_BOARD="stm32h7s78-dk"
CONFIG_ARCH_BOARD_STM32H7S78_DK=y
CONFIG_ARCH_CHIP="stm32h7rs"
CONFIG_ARCH_CHIP_STM32H7RS=y
CONFIG_ARCH_CHIP_STM32H7S7L8=y
CONFIG_ARM_MPU=y
CONFIG_ARM_MPU_NREGIONS=16
CONFIG_ARM_MPU_RESET=y
CONFIG_ARMV7M_DCACHE=y
CONFIG_ARMV7M_ICACHE=y
CONFIG_ARCH_INTERRUPTSTACK=2048
CONFIG_ARCH_STACKDUMP=y
CONFIG_BOARD_LATE_INITIALIZE=y
CONFIG_BOARD_LOOPSPERMSEC=60000
CONFIG_BOOT_NXBOOT=y
CONFIG_BENCHMARK_RAMSPEED=y
CONFIG_BUILTIN=y
CONFIG_INIT_ENTRYPOINT="nsh_main"
CONFIG_INTELHEX_BINARY=y
CONFIG_LIBC_FLOATINGPOINT=y
CONFIG_LIBC_STRERROR=y
# CONFIG_LIBC_UNAME_DISABLE_TIMESTAMP is not set
CONFIG_MM_REGIONS=2
CONFIG_MTD=y
CONFIG_NSH_ARCHINIT=y
CONFIG_NSH_BUILTIN_APPS=y
CONFIG_NSH_FILEIOSIZE=512
CONFIG_NSH_PROC_MOUNTPOINT="/proc"
CONFIG_NSH_READLINE=y
# CONFIG_NSH_DISABLE_FREE is not set
# CONFIG_NSH_DISABLE_PS is not set
CONFIG_FS_PROCFS=y
CONFIG_FS_PROCFS_REGISTER=y
# CONFIG_FS_PROCFS_EXCLUDE_MEMINFO is not set
# CONFIG_FS_PROCFS_EXCLUDE_PROCESS is not set
CONFIG_NXBOOT_HEADER_SIZE=0x400
CONFIG_NXBOOT_PLATFORM_IDENTIFIER=0x48735378
CONFIG_PREALLOC_TIMERS=4
CONFIG_RAM_SIZE=466944
CONFIG_RAM_START=0x24000000
CONFIG_RAW_BINARY=y
CONFIG_RR_INTERVAL=200
CONFIG_SCHED_HPWORK=y
CONFIG_SCHED_LPWORK=y
CONFIG_SCHED_WAITPID=y
CONFIG_START_DAY=6
CONFIG_START_MONTH=5
CONFIG_START_YEAR=2026
CONFIG_STM32H7RS_APP_FORMAT_NXBOOT=y
CONFIG_STM32H7RS_EXTNOR_OTA_PARTITION=y
CONFIG_STM32H7RS_GPIO=y
CONFIG_STM32H7RS_OTA_SECONDARY_SLOT_OFFSET=0x02000000
CONFIG_STM32H7RS_OTA_SLOT_SIZE=0x02000000
CONFIG_STM32H7RS_OTA_TERTIARY_SLOT_OFFSET=0x04000000
CONFIG_STM32H7RS_PSRAM_HEAP=y
CONFIG_STM32H7RS_PSRAM_HEAP_OFFSET=0x1000
CONFIG_STM32H7RS_USART=y
CONFIG_STM32H7RS_UART4_SERIALDRIVER=y
CONFIG_STM32H7RS_XSPI=y
CONFIG_SENSORS=y
CONFIG_SENSORS_LSM6DSOX=y
CONFIG_LSM6DSOX_DEVPATH="/dev/lsm6dsox"
CONFIG_LSM6DSOX_I2C_ADDRESS=0x6a
CONFIG_LSM6DSOX_I2C_FREQUENCY=400000
CONFIG_LSM6DSOX_ACCEL_ODR=4
CONFIG_LSM6DSOX_ACCEL_FS=0
CONFIG_LSM6DSOX_GYRO_ODR=4
CONFIG_LSM6DSOX_GYRO_FS=0
CONFIG_LSM6DSOX_RESET_WAIT_MS=50
CONFIG_EXAMPLES_LSM6DSOX_DEMO=y
CONFIG_EXAMPLES_LSM6DSOX_DEMO_DEVPATH="/dev/lsm6dsox"
CONFIG_EXAMPLES_LSM6DSOX_DEMO_PROGNAME="lsm6dsox_demo"
CONFIG_I2CTOOL_MINBUS=1
CONFIG_I2CTOOL_MAXBUS=1
CONFIG_I2CTOOL_DEFFREQ=400000
CONFIG_STM32H7RS_I2C=y
CONFIG_STM32H7RS_I2C1=y
CONFIG_STM32H7S78_DK_LSM6DSOX=y
CONFIG_SYSTEM_I2CTOOL=y
CONFIG_SYSTEM_NSH=y
CONFIG_TESTING_MEMORY_STRESS=y
CONFIG_TESTING_RAMTEST=y
CONFIG_UART4_SERIAL_CONSOLE=y
CONFIG_USER_ENTRYPOINT="nsh_main"
```

## boards/arm/stm32h7rs/stm32h7s78-dk/configs/nsh-max30102/defconfig
```kconfig
CONFIG_ARCH="arm"
CONFIG_ARCH_BOARD="stm32h7s78-dk"
CONFIG_ARCH_BOARD_STM32H7S78_DK=y
CONFIG_ARCH_CHIP="stm32h7rs"
CONFIG_ARCH_CHIP_STM32H7RS=y
CONFIG_ARCH_CHIP_STM32H7S7L8=y
CONFIG_ARM_MPU=y
CONFIG_ARM_MPU_NREGIONS=16
CONFIG_ARM_MPU_RESET=y
CONFIG_ARMV7M_DCACHE=y
CONFIG_ARMV7M_ICACHE=y
CONFIG_ARCH_INTERRUPTSTACK=2048
CONFIG_ARCH_STACKDUMP=y
CONFIG_BOARD_LATE_INITIALIZE=y
CONFIG_BOARD_LOOPSPERMSEC=60000
CONFIG_BOOT_NXBOOT=y
CONFIG_BENCHMARK_RAMSPEED=y
CONFIG_BUILTIN=y
CONFIG_INIT_ENTRYPOINT="nsh_main"
CONFIG_INTELHEX_BINARY=y
CONFIG_LIBC_FLOATINGPOINT=y
CONFIG_LIBC_STRERROR=y
# CONFIG_LIBC_UNAME_DISABLE_TIMESTAMP is not set
CONFIG_MM_REGIONS=2
CONFIG_MTD=y
CONFIG_NSH_ARCHINIT=y
CONFIG_NSH_BUILTIN_APPS=y
CONFIG_NSH_FILEIOSIZE=512
CONFIG_NSH_PROC_MOUNTPOINT="/proc"
CONFIG_NSH_READLINE=y
# CONFIG_NSH_DISABLE_FREE is not set
# CONFIG_NSH_DISABLE_PS is not set
CONFIG_FS_PROCFS=y
CONFIG_FS_PROCFS_REGISTER=y
# CONFIG_FS_PROCFS_EXCLUDE_MEMINFO is not set
# CONFIG_FS_PROCFS_EXCLUDE_PROCESS is not set
CONFIG_NXBOOT_HEADER_SIZE=0x400
CONFIG_NXBOOT_PLATFORM_IDENTIFIER=0x48735378
CONFIG_PREALLOC_TIMERS=4
CONFIG_RAM_SIZE=466944
CONFIG_RAM_START=0x24000000
CONFIG_RAW_BINARY=y
CONFIG_RR_INTERVAL=200
CONFIG_SCHED_HPWORK=y
CONFIG_SCHED_LPWORK=y
CONFIG_SCHED_WAITPID=y
CONFIG_START_DAY=6
CONFIG_START_MONTH=5
CONFIG_START_YEAR=2026
CONFIG_STM32H7RS_APP_FORMAT_NXBOOT=y
CONFIG_STM32H7RS_EXTNOR_OTA_PARTITION=y
CONFIG_STM32H7RS_GPIO=y
CONFIG_STM32H7RS_OTA_SECONDARY_SLOT_OFFSET=0x02000000
CONFIG_STM32H7RS_OTA_SLOT_SIZE=0x02000000
CONFIG_STM32H7RS_OTA_TERTIARY_SLOT_OFFSET=0x04000000
CONFIG_STM32H7RS_PSRAM_HEAP=y
CONFIG_STM32H7RS_PSRAM_HEAP_OFFSET=0x1000
CONFIG_STM32H7RS_USART=y
CONFIG_STM32H7RS_UART4_SERIALDRIVER=y
CONFIG_STM32H7RS_XSPI=y
CONFIG_SENSORS=y
CONFIG_SENSORS_MAX30102=y
CONFIG_MAX30102_DEVPATH="/dev/max30102"
CONFIG_MAX30102_I2C_ADDRESS=0x57
CONFIG_MAX30102_I2C_FREQUENCY=400000
CONFIG_MAX30102_SAMPLE_WAIT_MS=1000
CONFIG_MAX30102_FIFO_AVERAGE=2
CONFIG_MAX30102_ADC_RANGE=2
CONFIG_MAX30102_SAMPLE_RATE=1
CONFIG_MAX30102_PULSE_WIDTH=3
CONFIG_MAX30102_LED1_PA=0x24
CONFIG_MAX30102_LED2_PA=0x24
CONFIG_EXAMPLES_MAX30102_DEMO=y
CONFIG_EXAMPLES_MAX30102_DEMO_DEVPATH="/dev/max30102"
CONFIG_EXAMPLES_MAX30102_DEMO_PROGNAME="max30102_demo"
CONFIG_I2CTOOL_MINBUS=1
CONFIG_I2CTOOL_MAXBUS=1
CONFIG_I2CTOOL_DEFFREQ=400000
CONFIG_STM32H7RS_I2C=y
CONFIG_STM32H7RS_I2C1=y
CONFIG_STM32H7S78_DK_MAX30102=y
CONFIG_SYSTEM_I2CTOOL=y
CONFIG_SYSTEM_NSH=y
CONFIG_TESTING_MEMORY_STRESS=y
CONFIG_TESTING_RAMTEST=y
CONFIG_UART4_SERIAL_CONSOLE=y
CONFIG_USER_ENTRYPOINT="nsh_main"
```
