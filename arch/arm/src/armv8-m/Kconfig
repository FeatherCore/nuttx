## boards/arm/stm32u5/stm32u5x9j-dk/Kconfig
```kconfig
#
# For a description of the syntax of this configuration file,
# see the file kconfig-language.txt in the NuttX tools repository.
#

if ARCH_BOARD_STM32U5X9J_DK

menu "STM32U5x9J-DK Peripheral Bring-up"

config STM32U5X9J_DK_USERLEDS
	bool "LED3/LED4 user LED driver"
	default y
	select USERLED
	select USERLED_LOWER
	---help---
		Register LED3 and LED4 through the generic /dev/userleds lower half.

config STM32U5X9J_DK_BUTTONS
	bool "USER button driver"
	default y
	select ARCH_BUTTONS
	select ARCH_IRQBUTTONS
	select INPUT
	select INPUT_BUTTONS
	select INPUT_BUTTONS_LOWER
	---help---
		Register the USER button on PC13 through /dev/buttons.

config STM32U5X9J_DK_I2C_BUSES
	bool "Register I2C2/I2C3/I2C4/I2C5"
	default y
	select I2C
	select I2C_DRIVER
	select STM32U5_I2C2
	select STM32U5_I2C3
	select STM32U5_I2C4
	select STM32U5_I2C5
	---help---
		Expose the board BSP I2C buses as /dev/i2c2, /dev/i2c3,
		/dev/i2c4, and /dev/i2c5.

config STM32U5X9J_DK_I2C_PROBES
	bool "Board I2C sensor device nodes"
	default y
	depends on STM32U5X9J_DK_I2C_BUSES
	---help---
		Register pure-NuttX character devices for the board I2C sensors:
		/dev/temp0 for STTS22H one-shot temperature read and /dev/range0
		for VL53L5CX identity/health probing.

config STM32U5X9J_DK_OSPI_NOR
	bool "OSPI1 MX25UM51245G NOR"
	default y
	select STM32U5_OCTOSPIM
	select STM32U5_OCTOSPI1
	---help---
		Initialize the 64 MiB MX25UM51245G external NOR, read its JEDEC
		ID, and leave it in memory-mapped mode at the OCTOSPI1 XIP
		window. The default bring-up does not register the NOR as a
		writable device because this region is reserved for later XIP code.

config STM32U5X9J_DK_OSPI_MTD
	bool "Register OSPI1 NOR as /dev/mtd0"
	default n
	depends on STM32U5X9J_DK_OSPI_NOR
	select MTD
	---help---
		Optional development path that exposes the external NOR through
		/dev/mtd0. Keep this disabled when the NOR is used as an XIP
		execution region.

config STM32U5X9J_DK_OSPI_DIAG
	bool "OSPI1 NOR diagnostic node"
	default n
	depends on STM32U5X9J_DK_OSPI_NOR
	---help---
		Register /dev/ospi0 with non-destructive MX25UM51245G diagnostic
		information: size, geometry, JEDEC ID, XIP base, and first mapped
		word. This node does not erase or write flash by default.

config STM32U5X9J_DK_OSPI_SCRATCH_TEST
	bool "Enable manual destructive OSPI scratch test"
	default n
	depends on STM32U5X9J_DK_OSPI_DIAG
	---help---
		Allow writing "scratch" to /dev/ospi0 to erase, program, read back,
		and compare one 4 KiB scratch subsector. This is intentionally
		disabled by default because it destroys flash contents at the
		configured offset.

config STM32U5X9J_DK_OSPI_SCRATCH_OFFSET
	hex "Manual OSPI scratch test offset"
	default 0x03ff0000
	depends on STM32U5X9J_DK_OSPI_SCRATCH_TEST
	---help---
		Offset used by the manual /dev/ospi0 scratch test. It must be 4 KiB
		aligned and must point to an expendable region.

config STM32U5X9J_DK_HSPI_RAM
	bool "HSPI1 APS512xx RAM"
	default y
	select STM32U5_HSPI1
	select STM32U5_PWR
	---help---
		Initialize the 64 MiB APS512xx PSRAM through HSPI1 and map it at
		0xa0000000.

config STM32U5X9J_DK_HSPI_HEAP
	bool "Add HSPI PSRAM to heap"
	default y
	depends on STM32U5X9J_DK_HSPI_RAM
	---help---
		Reserve the PSRAM framebuffer window for display bring-up and add
		the remaining PSRAM region to the NuttX heap in arm_addregion().

config STM32U5X9J_PROTECTED_USRAM_BASE
	hex "Protected build user SRAM base"
	default 0x20250000
	depends on BUILD_PROTECTED && MM_KERNEL_HEAP
	---help---
		Base of the internal SRAM window reserved for protected user
		.data/.bss and the bootstrap user heap.  The remaining internal
		SRAM below this address is used by kernel sections and kernel heap.

config STM32U5X9J_PROTECTED_USRAM_SIZE
	hex "Protected build user SRAM size"
	default 0x20000
	depends on BUILD_PROTECTED && MM_KERNEL_HEAP
	---help---
		Size of the protected build internal SRAM window reserved for user
		.data/.bss and the bootstrap user heap.

config STM32U5X9J_PROTECTED_UHEAP_SIZE
	hex "Protected build bootstrap user heap size"
	default 0x2000
	depends on BUILD_PROTECTED && MM_KERNEL_HEAP
	---help---
		Small initial user heap kept in the internal user SRAM window.
		The HSPI1 PSRAM heap is appended later by arm_addregion(), so early
		protected allocator metadata is not placed in memory-mapped PSRAM.

config STM32U5X9J_DK_HSPI_DIAG
	bool "HSPI1 PSRAM diagnostic node"
	default y
	depends on STM32U5X9J_DK_HSPI_RAM
	---help---
		Register /dev/hspiram0 with APS512xx base, size, framebuffer
		reservation, heap-region, mapped state, and self-test status. A
		manual "selftest" write runs a 32-byte save/write/read/restore
		check without claiming ownership of the full RAM.

config STM32U5X9J_DK_EMMC
	bool "SDMMC1 eMMC"
	default n
	select MMCSD
	select MMCSD_MMCSUPPORT
	select MMCSD_SDIO
	select SCHED_HPWORK
	select SCHED_WORKQUEUE
	select STM32U5_SDMMC1
	---help---
		Enable board-level eMMC bring-up on SDMMC1 using an 8-bit bus.

config STM32U5X9J_DK_EMMC_AUTOMOUNT
	bool "Try mounting existing vfat on /mnt/emmc"
	default n
	depends on STM32U5X9J_DK_EMMC && FS_FAT
	---help---
		Try to mount /dev/mmcsd0 as vfat at /mnt/emmc. Mount failure is
		only logged; the board never formats eMMC automatically.

config STM32U5X9J_DK_EMMC_INFO
	bool "eMMC read-only diagnostic node"
	default y
	depends on STM32U5X9J_DK_EMMC
	---help---
		Register /dev/emmcinfo0 with read-only geometry and block-0 smoke
		information. The diagnostic never erases, formats, or writes eMMC.

config STM32U5X9J_DK_LCD
	bool "DSI LCD framebuffer"
	default y
	select DRIVERS_VIDEO
	select VIDEO_FB
	select LCD_HX8379C
	select FB_UPDATE
	select FB_SYNC
	select STM32U5_DMA2D
	select STM32U5_DSIHOST
	select STM32U5_GPU2D
	select STM32U5_LTDC
	select STM32U5_LTDC_FB_DOUBLE_BUFFER
	---help---
		Register a 480x480 double framebuffer at /dev/fb0.

choice
	prompt "LCD framebuffer pixel format"
	default STM32U5X9J_DK_LCD_RGB565
	depends on STM32U5X9J_DK_LCD
	---help---
		Select the pixel format exposed by /dev/fb0 when the LCD is
		enabled. This board choice is the source for the framebuffer,
		LVGL color depth, LTDC, DSI host, and panel pixel-format
		configuration.

config STM32U5X9J_DK_LCD_RGB565
	bool "RGB565"

config STM32U5X9J_DK_LCD_XRGB8888
	bool "XRGB8888 (32-bit LTDC ARGB8888)"
	---help---
		Expose /dev/fb0 as FB_FMT_RGB32/XRGB8888.  The LTDC layer
		still uses the STM32 ARGB8888 pixel-format packing, but the
		display layer is configured with constant alpha so LVGL's final
		framebuffer is treated as fully opaque.

endchoice

choice
	prompt "LCD framebuffer backing memory"
	default STM32U5X9J_DK_LCD_FB_PSRAM
	depends on STM32U5X9J_DK_LCD
	---help---
		Select where the display framebuffer storage lives.  This board
		choice also selects whether the LTDC path should use the GFXMMU.

config STM32U5X9J_DK_LCD_FB_PSRAM
	bool "HSPI1 PSRAM, direct linear LTDC scanout"
	select STM32U5X9J_DK_HSPI_RAM
	---help---
		Expose the reserved HSPI1 PSRAM framebuffer directly to LTDC and
		fbdev.  This is the normal LVGL mode: PSRAM has enough capacity,
		and the direct linear scanout path avoids LTDC FIFO underruns
		caused by GFXMMU translation latency.

config STM32U5X9J_DK_LCD_FB_SRAM
	bool "Internal SRAM, GFXMMU-backed circular framebuffer"
	depends on BUILD_PROTECTED && MM_KERNEL_HEAP
	select STM32U5_GFXMMU
	---help---
		Reserve internal SRAM below the protected user SRAM window for
		the LCD framebuffer and expose it through the GFXMMU virtual
		framebuffer windows.  This mode is intended for memory-constrained
		internal-SRAM experiments; the linker script and board heap code
		remove the reserved framebuffer storage from the kernel heap.

endchoice

config STM32U5X9J_DK_LCD_COLORBAR
	bool "Draw LCD color bars during bring-up"
	default n
	depends on STM32U5X9J_DK_LCD
	---help---
		Fill the framebuffer with vertical color bars after LCD bring-up.

config STM32U5X9J_DK_LCD_PATTERN
	bool "Draw extended LCD static pattern during bring-up"
	default n
	depends on STM32U5X9J_DK_LCD_COLORBAR
	---help---
		Draw a non-interactive framebuffer smoke pattern by overlaying
		basic RGB rectangles on top of the vertical color bars.

config STM32U5X9J_DK_TOUCH
	bool "Sitronix touchscreen"
	default y
	depends on STM32U5X9J_DK_I2C_BUSES
	select INPUT
	select INPUT_SITRONIX
	---help---
		Register the Sitronix touch controller on I2C5 through the generic
		NuttX touchscreen upper half at /dev/input0.

config STM32U5X9J_DK_STTS22H
	bool "STTS22H temperature sensor"
	default y
	depends on STM32U5X9J_DK_I2C_PROBES

config STM32U5X9J_DK_VL53L5CX
	bool "VL53L5CX ranging sensor"
	default y
	depends on STM32U5X9J_DK_I2C_PROBES
	---help---
		Register the minimum pure-NuttX VL53L5CX /dev/range0 path. Full
		ranging is intentionally blocked until the opaque firmware/config
		table dependency is isolated.

endmenu

endif
```

## boards/sim/sim/sim/configs/hwsim_ble1_hcisock_probe/defconfig
```kconfig
#
# Linux-semantics Bluetooth hwsim simulator config.
# Isolated BLE1 probe for upstream hci_sock.c bring-up.
#
CONFIG_ALLOW_BSD_COMPONENTS=y
CONFIG_CRYPTO=y
CONFIG_CRYPTO_AES=y
CONFIG_CRYPTO_SW_AES=y
CONFIG_ARCH="sim"
CONFIG_ARCH_BOARD="sim"
CONFIG_ARCH_BOARD_SIM=y
CONFIG_ARCH_CHIP="sim"
CONFIG_ARCH_SIM=y
CONFIG_BOARDCTL_POWEROFF=y
CONFIG_BOARD_LOOPSPERMSEC=0
CONFIG_BOOT_RUNFROMEXTSRAM=y
CONFIG_BUILTIN=y
CONFIG_DEBUG_SYMBOLS=y
CONFIG_DEV_LOOP=y
CONFIG_DEV_URANDOM=y
CONFIG_DRIVERS_WIRELESS=y
CONFIG_FS_HOSTFS=y
CONFIG_FS_PROCFS=y
CONFIG_FS_TMPFS=y
CONFIG_IDLETHREAD_STACKSIZE=4096
CONFIG_INIT_ENTRYPOINT="nsh_main"
CONFIG_LIBC_ENVPATH=y
CONFIG_LIBC_EXECFUNCS=y
CONFIG_LIBC_MAX_EXITFUNS=1
CONFIG_NET=y
CONFIG_NETINIT_NETLOCAL=y
CONFIG_NET_LOCAL=y
CONFIG_NET_NETLINK=y
CONFIG_NET_PKT=y
CONFIG_NET_PKT_ALLOC_CONNS=8
CONFIG_NET_PKT_PREALLOC_CONNS=8
CONFIG_NET_STATISTICS=y
CONFIG_NSH_BUILTIN_APPS=y
CONFIG_NSH_FILE_APPS=y
CONFIG_NSH_READLINE=y
CONFIG_PATH_INITIAL="/bin"
CONFIG_PREALLOC_MQ_MSGS=64
CONFIG_READLINE_TABCOMPLETION=y
CONFIG_SCHED_HAVE_PARENT=y
CONFIG_SCHED_WAITPID=y
CONFIG_SIM_BTHWSIM=y
CONFIG_SIM_BTHWSIM_MEDIUM_DIR="/tmp/nuttx-bthwsim"
CONFIG_SYSTEM_NSH=y
CONFIG_WIRELESS=y
CONFIG_NET_LINUX_BLUETOOTH=y
CONFIG_NET_LINUX_BLUETOOTH_UPSTREAM_SOURCES=y
CONFIG_NET_LINUX_BLUETOOTH_UPSTREAM_LIB=y
CONFIG_NET_LINUX_BLUETOOTH_UPSTREAM_AF=y
CONFIG_NET_LINUX_BLUETOOTH_UPSTREAM_HCI_CORE=y
CONFIG_NET_LINUX_BLUETOOTH_UPSTREAM_HCI_SOCK=y
CONFIG_NET_LINUX_BLUETOOTH_UPSTREAM_MGMT=y
CONFIG_NET_LINUX_BLUETOOTH_UPSTREAM_L2CAP=y
CONFIG_NET_LINUX_BLUETOOTH_UPSTREAM_SMP=y
CONFIG_NET_LINUX_BLUETOOTH_UPSTREAM_ISO=y
CONFIG_NET_LINUX_BLUETOOTH_UPSTREAM_HCI_VHCI=y
CONFIG_NET_LINUX_BLUETOOTH_UPSTREAM_HCI_VHCI_AUTOSTART=y
CONFIG_NET_LINUX_BLUETOOTH_HCI=y
CONFIG_NET_LINUX_BLUETOOTH_L2CAP=y
CONFIG_NET_LINUX_BLUETOOTH_SMP=y
CONFIG_NET_LINUX_BLUETOOTH_ATT_GATT=y
CONFIG_NET_LINUX_BLUETOOTH_A2DP=y
CONFIG_NET_LINUX_BLUETOOTH_ISO=y
CONFIG_NET_LINUX_BLUETOOTH_MAX_CONN=4
CONFIG_DRIVERS_BLUETOOTH_LINUX=y
CONFIG_DRIVERS_BLUETOOTH_LINUX_HCI_VHCI=y
CONFIG_LIBC_HOSTNAME="NuttX-HWSIM-BLE1-HCISOCK"
CONFIG_SIM_BTHWSIM_ROLE=3
CONFIG_SIM_BTHWSIM_MODE="le"
CONFIG_LINUX_BTCTL=y
CONFIG_LINUX_BTCTL_PROGNAME="btctl"
CONFIG_LINUX_BTCTL_PRIORITY=100
CONFIG_LINUX_BTCTL_STACKSIZE=4096
CONFIG_LINUX_BTAUDIO=y
CONFIG_LINUX_BTAUDIO_PROGNAME="btaudio"
CONFIG_LINUX_BTAUDIO_PRIORITY=100
CONFIG_LINUX_BTAUDIO_STACKSIZE=4096
```

## boards/sim/sim/sim/configs/hwsim_bt1/defconfig
```kconfig
#
# Linux-semantics Bluetooth hwsim simulator config.
# Generated for FeatherCore BT/BLE hwsim bring-up.
#
CONFIG_ALLOW_BSD_COMPONENTS=y
CONFIG_CRYPTO=y
CONFIG_CRYPTO_AES=y
CONFIG_CRYPTO_SW_AES=y
CONFIG_ARCH="sim"
CONFIG_ARCH_BOARD="sim"
CONFIG_ARCH_BOARD_SIM=y
CONFIG_ARCH_CHIP="sim"
CONFIG_ARCH_SIM=y
CONFIG_BOARDCTL_POWEROFF=y
CONFIG_BOARD_LOOPSPERMSEC=0
CONFIG_BOOT_RUNFROMEXTSRAM=y
CONFIG_BUILTIN=y
CONFIG_DEBUG_SYMBOLS=y
CONFIG_DEV_LOOP=y
CONFIG_DEV_URANDOM=y
CONFIG_DRIVERS_WIRELESS=y
CONFIG_FS_HOSTFS=y
CONFIG_FS_PROCFS=y
CONFIG_FS_TMPFS=y
CONFIG_IDLETHREAD_STACKSIZE=4096
CONFIG_INIT_ENTRYPOINT="nsh_main"
CONFIG_LIBC_ENVPATH=y
CONFIG_LIBC_EXECFUNCS=y
CONFIG_LIBC_MAX_EXITFUNS=1
CONFIG_NET=y
CONFIG_NET_BROADCAST=y
CONFIG_NET_ARP=y
CONFIG_NET_ETHERNET=y
CONFIG_NET_ETH_PKTSIZE=1514
CONFIG_NET_ICMP=y
CONFIG_NET_ICMP_SOCKET=y
CONFIG_NET_IPFRAG=y
CONFIG_NET_IPv4=y
CONFIG_NETINIT_NETLOCAL=y
CONFIG_NET_LOCAL=y
CONFIG_NET_LOOPBACK=y
CONFIG_NET_NETLINK=y
CONFIG_NET_PKT=y
CONFIG_NET_PKT_ALLOC_CONNS=8
CONFIG_NET_PKT_PREALLOC_CONNS=8
CONFIG_NET_STATISTICS=y
CONFIG_NET_SOCKOPTS=y
CONFIG_NET_TCP=y
CONFIG_NET_TCP_WRITE_BUFFERS=y
CONFIG_NET_TUN=y
CONFIG_NET_TUN_PKTSIZE=1500
CONFIG_NET_UDP=y
CONFIG_NET_UDP_WRITE_BUFFERS=y
CONFIG_NETUTILS_IPERF=y
CONFIG_NETUTILS_IPERFTEST_DEVNAME="btn0"
CONFIG_NSH_BUILTIN_APPS=y
CONFIG_NSH_FILE_APPS=y
CONFIG_NSH_READLINE=y
CONFIG_PATH_INITIAL="/bin"
CONFIG_PREALLOC_MQ_MSGS=64
CONFIG_READLINE_TABCOMPLETION=y
CONFIG_SCHED_HAVE_PARENT=y
CONFIG_SCHED_WAITPID=y
CONFIG_SIM_BTHWSIM=y
CONFIG_SIM_BTHWSIM_MEDIUM_DIR="/tmp/nuttx-bthwsim"
CONFIG_SIM_NETDEV=y
CONFIG_SYSTEM_NSH=y
CONFIG_SYSTEM_PING=y
CONFIG_WIRELESS=y
CONFIG_NET_LINUX_BLUETOOTH=y
CONFIG_NET_LINUX_BLUETOOTH_UPSTREAM_SOURCES=y
CONFIG_NET_LINUX_BLUETOOTH_UPSTREAM_LIB=y
CONFIG_NET_LINUX_BLUETOOTH_UPSTREAM_AF=y
CONFIG_NET_LINUX_BLUETOOTH_UPSTREAM_HCI_CORE=y
CONFIG_NET_LINUX_BLUETOOTH_UPSTREAM_HCI_SOCK=y
CONFIG_NET_LINUX_BLUETOOTH_UPSTREAM_MGMT=y
CONFIG_NET_LINUX_BLUETOOTH_UPSTREAM_L2CAP=y
CONFIG_NET_LINUX_BLUETOOTH_UPSTREAM_SMP=y
CONFIG_NET_LINUX_BLUETOOTH_UPSTREAM_ISO=y
CONFIG_NET_LINUX_BLUETOOTH_UPSTREAM_BNEP=y
CONFIG_NET_LINUX_BLUETOOTH_UPSTREAM_HCI_VHCI=y
CONFIG_NET_LINUX_BLUETOOTH_UPSTREAM_HCI_VHCI_AUTOSTART=y
CONFIG_NET_LINUX_BLUETOOTH_HCI=y
CONFIG_NET_LINUX_BLUETOOTH_L2CAP=y
CONFIG_NET_LINUX_BLUETOOTH_SMP=y
CONFIG_NET_LINUX_BLUETOOTH_ATT_GATT=y
CONFIG_NET_LINUX_BLUETOOTH_A2DP=y
CONFIG_NET_LINUX_BLUETOOTH_ISO=y
CONFIG_NET_LINUX_BLUETOOTH_MAX_CONN=4
CONFIG_DRIVERS_BLUETOOTH_LINUX=y
CONFIG_DRIVERS_BLUETOOTH_LINUX_HCI_VHCI=y
CONFIG_LIBC_HOSTNAME="NuttX-HWSIM-BT1"
CONFIG_SIM_BTHWSIM_ROLE=1
CONFIG_SIM_BTHWSIM_MODE="bredr"
CONFIG_LINUX_BTCTL=y
CONFIG_LINUX_BTCTL_PROGNAME="btctl"
CONFIG_LINUX_BTCTL_PRIORITY=100
CONFIG_LINUX_BTCTL_STACKSIZE=4096
CONFIG_LINUX_BTAUDIO=y
CONFIG_LINUX_BTAUDIO_PROGNAME="btaudio"
CONFIG_LINUX_BTAUDIO_PRIORITY=100
CONFIG_LINUX_BTAUDIO_STACKSIZE=4096
CONFIG_LINUX_BLUEZ_AUDIO_LIBSBC=y
CONFIG_LINUX_BTVHCID=y
CONFIG_LINUX_BTVHCID_PROGNAME="btvhcid"
CONFIG_LINUX_BTVHCID_PRIORITY=100
CONFIG_LINUX_BTVHCID_STACKSIZE=8192
```
