## drivers/bluetooth/Kconfig
```kconfig
#############################################################################
# drivers/bluetooth/Kconfig
#
# SPDX-License-Identifier: Apache-2.0
#############################################################################

menuconfig DRIVERS_BLUETOOTH_LINUX
	bool "Linux Bluetooth controller driver port"
	default y if NET_LINUX_BLUETOOTH
	depends on NET_LINUX_BLUETOOTH
	---help---
		Enable the Linux-style Bluetooth controller driver port area.
		This directory mirrors Linux drivers/bluetooth and is separate from
		the Linux host stack port under wireless/linux_bluetooth.

if DRIVERS_BLUETOOTH_LINUX

config DRIVERS_BLUETOOTH_LINUX_HCI_VHCI
	bool "Build imported Linux drivers/bluetooth/hci_vhci.c"
	default y if NET_LINUX_BLUETOOTH_UPSTREAM_HCI_VHCI
	depends on NET_LINUX_BLUETOOTH_UPSTREAM_HCI_VHCI
	---help---
		Compile the imported Linux virtual HCI driver from the
		wireless/linux_bluetooth/upstream/drivers_bluetooth staging area,
		but do so from the NuttX drivers/bluetooth layer.  This matches
		Linux's split between net/bluetooth host stack code and
		drivers/bluetooth controller drivers.

endif # DRIVERS_BLUETOOTH_LINUX
```

## drivers/wireless/esp_hosted_ng/Kconfig
```kconfig
#
# For a description of the syntax of this configuration file,
# see the file kconfig-language.txt in the NuttX tools repository.
#

menu "ESP-Hosted NG Wi-Fi"

config WL_ESP_HOSTED_NG
	bool "ESP-Hosted NG host driver glue"
	default n
	depends on DRIVERS_WIRELESS && NET && WIRELESS_IEEE80211_CFG80211_LINUX
	select SPI
	select SPI_EXCHANGE
	select DRIVERS_IEEE80211
	select WIRELESS_ESP_HOSTED_NG
	select WIRELESS_ESP_HOSTED_NG_SPI
	---help---
		Enable the NuttX-side ESP-Hosted NG host driver glue.  The
		upstream ESP-Hosted NG host driver is staged under
		apps/wireless/esp_hosted_ng/upstream/host and is being adapted to
		the NuttX Linux cfg80211/nl80211 port.

if WL_ESP_HOSTED_NG

config WL_ESP_HOSTED_NG_LINUX_CFG80211
	bool "Use Linux cfg80211 ESP-Hosted NG host path"
	default y
	---help---
		Build the ESP-Hosted NG host driver through the Linux-style
		cfg80211/nl80211 path.  This is the path used by wpa_supplicant:
		wpa_supplicant -> nl80211 -> cfg80211 -> ESP-Hosted driver.

config WL_ESP_HOSTED_NG_LEGACY_WEXT_DEMO
	bool "Use legacy Wireless Extensions bring-up path"
	default n
	---help---
		Build the early NuttX lower-half demo path that accepts ESSID and
		passphrase through wireless ioctls.  This bypasses nl80211 and is
		kept only as a bring-up fallback.

config WL_ESP_HOSTED_NG_SPI_DEV
	int "SPI bus number connected to ESP32-C5"
	default 1
	---help---
		NuttX SPI bus number wired to the ESP32-C5 ESP-Hosted NG SPI
		interface.

config WL_ESP_HOSTED_NG_SPI_FREQUENCY
	int "Initial SPI frequency"
	default 10000000
	---help---
		Initial SPI clock for ESP-Hosted NG transactions.  This mirrors
		the Linux ESP-Hosted default of 10 MHz.

config WL_ESP_HOSTED_NG_SPI_MODE
	int "SPI mode"
	default 2
	range 0 3
	---help---
		ESP-Hosted NG Linux host driver uses SPI mode 2 by default.

config WL_ESP_HOSTED_NG_HANDSHAKE_PIN
	int "Handshake GPIO pin"
	default -1
	---help---
		Host GPIO connected to the ESP32-C5 handshake line.  The Linux
		ESP-Hosted reference uses this rising edge to start a full-duplex
		SPI transaction.  -1 means the board binding is not defined yet.

config WL_ESP_HOSTED_NG_DATA_READY_PIN
	int "Data ready GPIO pin"
	default -1
	---help---
		Host GPIO connected to the ESP32-C5 data-ready line.  The Linux
		ESP-Hosted reference uses this rising edge when the ESP has a
		frame queued for the host.  -1 means the board binding is not
		defined yet.

config WL_ESP_HOSTED_NG_RESET_PIN
	int "ESP32-C5 reset GPIO pin"
	default -1
	---help---
		Optional host GPIO connected to ESP32-C5 EN/reset.

config WL_ESP_HOSTED_NG_IFNAME
	string "Wi-Fi interface name"
	default "wlan0"
	---help---
		Expected network interface name exported by the ESP-Hosted NG
		cfg80211 glue once the transport port is complete.

endif # WL_ESP_HOSTED_NG

endmenu
```

## drivers/wireless/virtual/Kconfig
```kconfig
#
# For a description of the syntax of this configuration file,
# see the file kconfig-language.txt in the NuttX tools repository.
#

menu "Virtual IEEE 802.11 devices"

config WL_VIRTUAL
	bool "Virtual Wi-Fi driver support"
	default n
	depends on DRIVERS_WIRELESS
	---help---
		Enable NuttX virtual Wi-Fi driver support. The imported Linux
		source files live in this directory as a vendor reference while
		the NuttX compatibility layer is being completed.

if WL_VIRTUAL

config WL_NUTTX_HWSIM
	bool "NuttX simulator virtual Wi-Fi hwsim driver"
	default n
	depends on ARCH_SIM && DRIVERS_WIFI_SIM && SIM_WIFIDEV_PSEUDO
	---help---
		Enable the NuttX simulator virtual Wi-Fi entry point. This
			driver provides the NuttX-facing hwsim hook used by sim
			configurations while the imported Linux mac80211_hwsim source is
			kept as the vendor reference for the full cfg80211/mac80211 port.

config WL_NUTTX_HWSIM_DEBUG
	bool "Print hwsim port debug events"
	default n
	depends on WL_NUTTX_HWSIM
	---help---
		Emit low-level hwsim, cfg80211, nl80211, and mac80211 porting
		debug logs. This is intended for simulator validation and should be
		left disabled in quiet runtime configurations.

config WL_NUTTX_HWSIM_RADIO_BASE
	int "NuttX hwsim radio MAC base"
	default 0
	depends on WL_NUTTX_HWSIM
	---help---
		Offset the auto-generated mac80211_hwsim radio MAC addresses. This
		lets separately launched simulator processes use distinct wlan0 MAC
		addresses while each process still creates its own local radio set.

config WL_NUTTX_HWSIM_RADIOS
	int "NuttX hwsim radio count"
	default 2
	range 0 100
	depends on WL_NUTTX_HWSIM
	---help---
		Select how many mac80211_hwsim radios are created inside one
		simulator process. This mirrors the Linux mac80211_hwsim radios
		module parameter, which is not runtime-configurable in the NuttX
		port because module_param() is a compatibility no-op.

config WL_NUTTX_HWSIM_CHANNELS
	int "NuttX hwsim concurrent channel count"
	default 2
	range 1 64
	depends on WL_NUTTX_HWSIM
	---help---
		Select the advertised number of concurrent channels for one hwsim
		radio. This mirrors the Linux mac80211_hwsim channels module
		parameter and controls whether channel-context support is enabled.

config WL_NUTTX_HWSIM_MEDIUM_MAX_BYTES
	int "NuttX hwsim shared frame medium limit"
	default 67108864
	range 1048576 268435456
	depends on WL_NUTTX_HWSIM
	---help---
		Maximum size in bytes for the hostfs-backed hwsim shared frame
		medium before it is truncated. Larger values reduce false
		truncation during debug-heavy iperf, TWT, power-save, and wide
		channel validation runs while keeping a bounded host file.

config WL_NUTTX_HWSIM_MLO_SUPPORT
	bool "Enable hwsim MLO and dynamic power-save capability flags"
	default n
	depends on WL_NUTTX_HWSIM
	---help---
		Enable the imported mac80211_hwsim MLO path for validation builds.
		This sets WIPHY_FLAG_SUPPORTS_MLO plus SUPPORTS_DYNAMIC_PS,
		CONNECTION_MONITOR, and AP_LINK_PS when each radio is created.
		Keep this disabled for baseline AP/STA/P2P runs until the MLO and
		dynamic power-save runtime behavior is fully proven.

config WL_NUTTX_HWSIM_MULTI_RADIO_SUPPORT
	bool "Enable hwsim multi-radio-per-wiphy capability"
	default n
	depends on WL_NUTTX_HWSIM
	---help---
		Enable the imported mac80211_hwsim multi-radio capability for
		validation builds. This mirrors the Linux mac80211_hwsim
		multi_radio module parameter and forces channel-context support.

config WL_NUTTX_HWSIM_AMPDU_PROOF
	bool "Print hwsim A-MPDU proof events"
	default n
	depends on WL_NUTTX_HWSIM
	---help---
		Emit low-volume A-MPDU proof logs while validating the simulator
		mac80211_hwsim port. This is intended for AP/STA validation runs
		and only prints aggregation trigger, ADDBA, and ampdu_action state.

config WL_NUTTX_HWSIM_AMSDU_PROOF
	bool "Enable and print hwsim A-MSDU proof events"
	default n
	depends on WL_NUTTX_HWSIM
	---help---
		Enable the simulator hwsim A-MSDU capability bits needed for
		runtime validation and emit low-volume proof logs when mac80211
		actually builds an A-MSDU frame. Linux mac80211_hwsim does not
		enable these hardware flags by default, so keep this option
		limited to validation configurations.

config WL_NUTTX_HWSIM_DCM_PROOF
	bool "Enable and print hwsim HE DCM proof events"
	default n
	depends on WL_NUTTX_HWSIM
	---help---
		Enable simulator-only HE DCM capability bits and low-volume proof
		logs for runtime validation. Data-frame RX status injection is
		still gated by the /h/hwsim-dcm-proof marker file so non-DCM
		validation runs are not reported as HE DCM traffic.

config WL_NUTTX_HWSIM_PS_PROOF
	bool "Print hwsim power-save proof events"
	default n
	depends on WL_NUTTX_HWSIM
	---help---
		Emit low-volume mac80211 AP power-save proof logs while validating
		the simulator hwsim path. The trace points cover STA sleep/wake,
		unicast PS buffering, TIM changes, PS-Poll delivery, and wakeup
		delivery.

config WL_VIRTUAL_LINUX_VENDOR_DROP
	bool "Linux virtual wireless source drop"
	default n
	---help---
		Keep the Linux 7.0.10 virtual wireless source drop visible in
		the NuttX Kconfig tree. This option intentionally does not build
		the Linux files yet; mac80211_hwsim.c and virt_wifi.c require
		Linux module, cfg80211, mac80211, sk_buff, netlink, debugfs, and
		rhashtable compatibility that is still being ported.

endif

endmenu
```

## wireless/Kconfig
```kconfig
#
# For a description of the syntax of this configuration file,
# see the file kconfig-language.txt in the NuttX tools repository.
#

config WIRELESS
	bool "Wireless Support"
	default n
	---help---
		Enables overall support for Wireless library.

if WIRELESS

source "wireless/linux_bluetooth/Kconfig"
source "wireless/bluetooth/Kconfig"
source "wireless/ieee80211/Kconfig"
source "wireless/ieee802154/Kconfig"
source "wireless/pktradio/Kconfig"

endif # WIRELESS
```

## wireless/ieee80211/Kconfig
```kconfig
#
# For a description of the syntax of this configuration file,
# see the file kconfig-language.txt in the NuttX tools repository.
#

menu "IEEE 802.11 support"

config WIRELESS_IEEE80211_CFG80211_LINUX
	bool "Linux cfg80211/nl80211 vendor drop"
	default n
	---help---
		Enable the Linux cfg80211/nl80211 source drop imported from
		Linux 7.0.10. This is intentionally disabled by default until
		the Linux compatibility layer and NuttX generic netlink bridge
		are in place.

config WIRELESS_IEEE80211_NL80211_METADATA_ONLY
	bool "Register nl80211 generic-netlink metadata only"
	default y
	depends on WIRELESS_IEEE80211_CFG80211_LINUX
	---help---
		Register the nl80211 generic-netlink family name and multicast
		groups without dispatching the full Linux cfg80211 command table.
		This keeps hostapd/wpa_supplicant family discovery moving while
		the remaining cfg80211/mac80211 compatibility layer is completed.

config NL80211_TESTMODE
	bool "Enable nl80211 testmode command in the Linux wireless port"
	default n
	depends on WIRELESS_IEEE80211_CFG80211_LINUX
	---help---
		Enable the upstream nl80211 testmode command and driver hooks in
		the imported cfg80211/mac80211/mac80211_hwsim path. This is useful
		for simulator validation of hwsim-private hooks such as SET_PS and
		GET_PS.

config WIRELESS_IEEE80211_MAC80211_LINUX
	bool "Linux mac80211 vendor drop"
	default n
	select WIRELESS_IEEE80211_CFG80211_LINUX
	---help---
		Enable the Linux mac80211 source drop imported from Linux
		7.0.10. This builds the upstream mac80211 core against the
		local Linux compatibility layer.

endmenu
```
